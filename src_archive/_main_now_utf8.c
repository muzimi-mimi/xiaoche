/* USER CODE BEGIN Header */
/**
  ******************************************************************************
  * @file           : main.c
  * @brief          : Main program body
  ******************************************************************************
  * @attention
  *
  * Copyright (c) 2026 STMicroelectronics.
  * All rights reserved.
  *
  * This software is licensed under terms that can be found in the LICENSE file
  * in the root directory of this software component.
  * If no LICENSE file comes with this software, it is provided AS-IS.
  *
  ******************************************************************************
  */
/* USER CODE END Header */
/* Includes ------------------------------------------------------------------*/
#include "main.h"
#include "adc.h"
#include "tim.h"
#include "usart.h"
#include "gpio.h"

/* Private includes ----------------------------------------------------------*/
/* USER CODE BEGIN Includes */
#include "OLED.h"
#include "stm32f1xx_it.h"
#include "stdio.h"
#include <stdarg.h>
#include "myI2C.h"
#include "MPU6050.h"
#include "SR04.h"
#include "TB6612.h"
#include "encode.h"
#include "PID.h"
#include "ccd.h"
#include <math.h>
#include <string.h>
#include <stdlib.h>

#include "BlueSerial.h"
/* USER CODE END Includes */

/* Private typedef -----------------------------------------------------------*/
/* USER CODE BEGIN PTD */

/* USER CODE END PTD */

/* Private define ------------------------------------------------------------*/
/* USER CODE BEGIN PD */

/* USER CODE END PD */

/* Private macro -------------------------------------------------------------*/
/* USER CODE BEGIN PM */

/* USER CODE END PM */

/* Private variables ---------------------------------------------------------*/

/* USER CODE BEGIN PV */

/* USER CODE END PV */

/* Private function prototypes -----------------------------------------------*/
void SystemClock_Config(void);
/* USER CODE BEGIN PFP */

/* USER CODE END PFP */

/* Private user code ---------------------------------------------------------*/
/* USER CODE BEGIN 0 */

/* ==========================================================================
 *                    锟斤拷锟斤拷锟斤拷平锟斤拷小锟斤拷 锟斤拷锟斤拷 锟斤拷锟狡结构锟斤拷锟斤拷
 * ==========================================================================
 *
 * 硬锟斤拷锟斤拷STM32F103C8T6 @72MHz / MPU6050(锟斤拷锟絀2C: PB3,PB4) / TB6612 + 双锟斤拷锟斤拷锟斤拷
 *       OLED(锟斤拷锟絀2C: PB8,PB9) / USART3 锟斤拷锟斤拷(9600) / SR04 锟斤拷锟斤拷锟斤拷 / CCD 锟斤拷锟斤拷(ADC1_IN4)
 *
 * 锟斤拷锟侥ｏ拷唯一时锟斤拷锟斤拷 TIM3 锟叫断ｏ拷锟斤拷 HAL_TIM_PeriodElapsedCallback锟斤拷锟斤拷
 *
 *      TIM3  锟斤拷锟斤拷 hcount++ 锟斤拷锟斤拷锟斤拷欠锟剿わ拷锟?锟斤拷末尾锟斤拷 CCD_Div 锟斤拷频锟斤拷一帧 CCD
 *      10ms  锟斤拷锟斤拷 锟斤拷 MPU6050 -> 锟斤拷态锟斤拷锟斤拷 -> 偏锟斤拷锟斤拷锟斤拷 -> 直锟斤拷锟斤拷 / 锟斤拷锟斤拷锟斤拷
 *      50ms  锟斤拷锟斤拷 锟斤拷锟斤拷锟斤拷锟斤拷 -> 锟斤拷锟劫讹拷 -> 锟劫度伙拷 + 转锟斤拷
 *
 *  锟斤拷 TIM3 锟斤拷锟斤拷锟斤拷 10ms 一锟侥ｏ拷tim.c: Period = 10000-1锟斤拷锟斤拷锟斤拷锟斤拷 1ms锟斤拷
 *    锟斤拷锟斤拷锟斤拷锟斤拷诒锟斤拷锟酵拷锟斤拷锟?TICK_10MS / TICK_50MS 锟斤拷锟斤拷锟疥，锟斤拷锟斤拷平锟解环锟斤拷
 *    锟劫度伙拷锟斤拷锟斤拷锟?10 锟斤拷锟斤拷锟斤拷锟节放碉拷 10ms 锟斤拷为锟剿革拷 CCD 锟斤拷路锟斤拷get_CCD()
 *    一帧约 0.7ms锟斤拷锟斤拷 1ms 锟斤拷锟斤拷锟铰伙拷缘锟?70% 锟斤拷锟叫讹拷预锟姐并锟斤拷锟斤拷 TimerErrorFlag锟斤拷
 *
 * 锟斤拷锟斤拷锟结构锟斤拷锟解环锟斤拷锟斤拷锟节伙拷锟届）锟斤拷
 *
 *      锟劫度伙拷(50ms) 锟斤拷锟斤拷锟斤拷锟斤拷锟斤拷锟? AnglePID.Target 锟斤拷锟斤拷锟斤拷
 *                                              锟斤拷锟斤拷> 直锟斤拷锟斤拷(10ms) 锟斤拷锟斤拷> AvePWM 锟斤拷锟斤拷
 *      转锟斤拷(50ms) 锟斤拷锟斤拷锟斤拷锟斤拷锟斤拷锟斤拷锟斤拷锟斤拷锟斤拷锟斤拷锟斤拷锟斤拷锟斤拷锟斤拷锟斤拷锟斤拷锟斤拷锟斤拷锟斤拷锟斤拷锟斤拷锟斤拷锟斤拷锟斤拷锟斤拷锟斤拷锟斤拷锟斤拷锟洁─> DifPWM 锟斤拷锟斤拷锟斤拷锟斤拷锟斤拷锟斤拷锟斤拷锟斤拷锟斤拷锟斤拷锟斤拷锟斤拷锟斤拷锟斤拷锟斤拷锟斤拷锟斤拷锟斤拷
 *                                              锟斤拷                           锟斤拷
 *                          LeftPWM  = AvePWM + DifPWM/2  <锟斤拷锟斤拷锟斤拷锟斤拷锟斤拷锟斤拷锟斤拷锟斤拷锟斤拷锟斤拷锟斤拷锟斤拷锟斤拷锟斤拷锟斤拷锟斤拷锟斤拷锟斤拷
 *                          RightPWM = AvePWM - DifPWM/2  <锟斤拷锟斤拷锟斤拷锟斤拷锟斤拷锟斤拷锟斤拷锟斤拷锟斤拷锟斤拷锟斤拷锟斤拷锟斤拷锟斤拷锟斤拷锟斤拷锟斤拷锟斤拷
 *
 * 锟斤拷锟斤拷锟斤拷锟斤拷状态锟斤拷 CarState 锟斤拷锟斤拷锟斤拷锟铰凤拷状态锟斤拷锟斤拷锟藉）锟斤拷
 * 锟斤拷循锟斤拷(while(1))只锟斤拷锟斤拷锟斤拷锟铰ｏ拷刷 OLED锟斤拷锟斤拷锟斤拷锟斤拷锟斤拷锟筋。
 * 锟斤拷锟斤拷实时锟斤拷锟斤拷 + CCD 锟缴硷拷锟斤拷锟斤拷锟叫讹拷锟斤拷 锟斤拷锟斤拷 锟斤拷为 OLED_Update() 锟斤拷锟斤拷锟?I2C 锟斤拷
 * 1024 锟街节ｏ拷一锟斤拷要 ~23ms锟斤拷锟斤拷锟斤拷循锟斤拷锟斤拷全锟斤拷锟斤拷头锟斤拷
 * 锟斤拷 锟斤拷位锟斤拷锟斤拷锟斤拷锟斤拷锟斤拷锟斤拷锟斤拷式锟斤拷锟节凤拷锟斤拷锟斤拷删锟斤拷锟斤拷9600 锟斤拷锟斤拷锟斤拷每帧 ~21ms锟斤拷
 *   锟斤拷 OLED 锟斤拷锟斤拷锟斤拷锟斤拷锟斤拷循锟斤拷锟较碉拷实锟斤拷 44.6ms锟斤拷锟斤拷CCD 锟斤拷锟轿革拷锟斤拷 OLED 锟斤拷直锟接伙拷锟斤拷
 * ========================================================================== */

/* ===== 锟斤拷锟斤拷状态锟斤拷锟斤拷取锟斤拷锟斤拷锟节碉拷 runflag 锟斤拷锟斤拷锟斤拷锟斤拷=====
 *
 *   ST_IDLE     锟较碉拷默锟较★拷锟斤拷锟斤拷系纾拷锟斤拷锟斤拷锟街革拷睿幻?10ms 也写一锟斤拷 PWM=0
 *   ST_ERECT    锟斤拷锟斤拷锟斤拷锟斤拷甩锟街把筹拷锟节斤拷平锟解窗锟节ｏ拷锟筋长 ERECT_TIMEOUT_MS(3s)
 *   ST_BALANCE  锟斤拷锟斤拷直锟斤拷锟斤拷驶锟斤拷只锟斤拷锟斤拷锟阶刺拷锟斤拷锟狡斤拷饣?+ 锟劫度伙拷 + 转锟斤拷
 *
 * 迁锟斤拷路锟斤拷锟斤拷
 *   ST_IDLE    --锟秸碉拷 "1"--> StartErect() ------------> ST_ERECT
 *   ST_ERECT   --|Angle| <= ERECT_DONE_ANG---------->  ST_BALANCE
 *   ST_ERECT   --锟斤拷锟斤拷 ERECT_TIMEOUT_MS(3s)---------->  StopCar() -> ST_IDLE
 *   ST_BALANCE --|Angle| > ERECT_START_ANG---------->  StopCar() -> ST_IDLE
 *
 * CarState 锟角碉拷锟街节ｏ拷锟斤拷循锟斤拷写锟斤拷锟叫断讹拷锟斤拷锟叫讹拷要么锟斤拷锟斤拷"锟斤拷状态"锟斤拷要么锟斤拷锟斤拷
 * "锟斤拷状态锟斤拷写锟斤拷"锟斤拷锟斤拷锟斤拷锟斤拷锟斤拷锟斤拷锟饺拷锟斤拷锟斤拷圆锟斤拷锟揭拷俳锟斤拷锟斤拷锟斤拷锟斤拷锟?*/
#define ST_IDLE     0u
#define ST_ERECT    1u
#define ST_BALANCE  2u
volatile uint8_t CarState = ST_IDLE;

/* ===== 锟斤拷锟狡斤拷锟侥ｏ拷TIM3 锟斤拷锟斤拷 x 锟斤拷锟斤拷锟斤拷锟斤拷锟斤拷频 = 实锟绞斤拷锟斤拷 =====
 * 锟斤拷 锟斤拷 tim.c 锟斤拷 TIM3 锟斤拷 Period 时锟斤拷锟斤拷锟斤拷同锟斤拷锟斤拷锟斤拷锟斤拷锟斤拷 锟斤拷锟斤拷 锟斤拷锟斤拷锟斤拷"锟斤拷锟斤拷锟斤拷锟斤拷一锟斤拷"锟斤拷
 *   锟斤拷锟斤拷时锟戒。漏锟侥的猴拷锟斤拷锟斤拷锟?锟斤拷一锟斤拷"锟斤拷锟斤拷锟斤拷平锟解环/锟劫度伙拷锟斤拷锟斤拷锟?10 锟斤拷锟斤拷
 *     TIM3 = 1ms  (Period = 1000-1)   ->  TICK_10MS = 10, TICK_50MS = 50
 *     TIM3 = 10ms (Period = 10000-1)  ->  TICK_10MS = 1,  TICK_50MS = 5   <- 锟斤拷前
 *   锟斤拷 TIM3 锟脚碉拷 10ms 锟斤拷为锟剿革拷 CCD 锟斤拷路锟斤拷get_CCD() 一帧要 ~0.7ms锟斤拷
 *   锟斤拷 1ms 锟斤拷锟斤拷锟铰伙拷缘锟?70% 锟斤拷锟叫讹拷预锟姐并锟斤拷锟斤拷 TimerErrorFlag锟斤拷 */
#define TICK_10MS   1
#define TICK_50MS   5

uint32_t hcount = 0, Count1 = 0;

/* CCD 锟缴硷拷锟斤拷锟侥ｏ拷每锟斤拷 +1锟斤拷锟桔计碉拷 CCD_Div 锟斤拷锟斤拷锟揭恢★拷锟?
 * 锟截癸拷时锟斤拷 = CCD_Div x TIM3 锟斤拷锟斤拷(10ms)锟斤拷锟斤拷全锟斤拷锟叫断撅拷锟斤拷锟斤拷锟斤拷锟斤拷循锟斤拷锟睫关★拷 */
static uint16_t CCD_count = 0;
static uint8_t ReviveCount = 0;   // 锟皆讹拷锟斤拷锟斤拷锟斤拷锟斤拷锟斤拷锟斤拷锟斤拷锟斤拷前未使锟矫ｏ拷
char display_buf[128];
uint32_t Rx_buf[300];

//#define RX_BUF_SIZE  128
//char BlueSerial_RxPacket[RX_BUF_SIZE];   // 锟斤拷锟秸伙拷锟斤拷锟斤拷
//volatile uint8_t BlueSerial_RxFlag = 0;     // 帧锟斤拷杀锟街疚?
//static uint8_t RxState = 0;                 // 状态锟斤拷状态
//static uint16_t pRxPacket = 0;              // 锟斤拷前锟斤拷锟斤拷锟斤拷锟斤拷锟斤拷


int16_t AX, AY, AZ, GX, GY, GZ;
volatile uint8_t TimerErrorFlag;
volatile uint16_t TimerCount;

float AngleAcc;
float AngleGyro;
float Angle;

/* ================== 偏锟斤拷锟斤拷 Yaw锟斤拷Z 锟斤拷锟斤拷锟捷伙拷锟斤拷 ==================
 * 没锟叫达拷锟斤拷锟狡ｏ拷锟斤拷锟斤拷锟街ｏ拷锟斤拷锟斤拷锟绞憋拷锟斤拷刍锟斤拷锟斤拷锟斤拷锟斤拷丶锟斤拷悖?
 *
 * 1) 锟斤拷锟?YAW_LSB_PER_DPS = 16.384
 *      GYRO_CONFIG = 0x18 -> 锟斤拷2000锟斤拷/s -> 32768/2000 = 16.384 LSB/(锟斤拷/s)
 *      锟轿匡拷锟斤拷锟斤拷锟斤拷 锟斤拷250锟斤拷/s 锟斤拷 131锟斤拷直锟斤拷锟秸筹拷锟斤拷锟斤拷偏锟斤拷锟角诧拷 8 锟斤拷锟斤拷
 * 2) dt 锟教讹拷 0.01f锟斤拷锟斤拷锟斤拷 HAL_GetTick() 锟斤拷锟斤拷 锟斤拷锟斤拷锟斤拷呛愣?10ms 锟斤拷锟节ｏ拷
 *      锟斤拷 ms 锟斤拷锟斤拷锟斤拷锟斤拷锟斤拷锟诫抖锟斤拷锟斤拷染锟斤拷锟街★拷
 * 3) 全锟斤拷 float 锟斤拷锟斤拷 double锟斤拷Cortex-M3 锟斤拷 FPU锟斤拷double 锟斤拷锟斤拷锟侥ｏ拷猓硷拷锟?5 锟斤拷锟斤拷
 *
 * YAW_BIAS_DPS 锟斤拷 Z 锟斤拷锟斤拷偏锟斤拷锟疥定锟斤拷锟斤拷锟斤拷锟斤拷锟斤拷止 30s锟斤拷取锟斤拷锟斤拷 GZ 锟斤拷锟斤拷锟侥撅拷值 / 16.384锟斤拷
 *      锟疥定值 41.20 LSB / 16.384 = 2.51 锟斤拷/s
 *      锟斤拷锟斤拷值 39.45 LSB / 16.384 = 2.41 锟斤拷/s   <- 锟斤拷值
 *   锟斤拷锟轿诧拷 1.67 LSB(锟斤拷0.10 锟斤拷/s)锟斤拷锟斤拷锟斤拷锟铰讹拷锟斤拷锟较碉拷状态锟斤拷锟斤拷锟皆诧拷要指锟斤拷写锟斤拷一锟斤拷值
 *   锟斤拷远准确 锟斤拷锟斤拷 锟斤拷锟斤拷锟饺碉拷锟斤拷锟斤拷锟斤拷锟较电静止时锟皆讹拷锟疥定锟斤拷
 *   锟斤拷锟斤拷 0.10 锟斤拷/s 锟斤拷锟斤拷锟斤拷锟斤拷锟斤拷锟斤拷 6 锟斤拷/min 锟侥筹拷锟斤拷漂锟狡★拷
 *
 * YAW_DEADZONE_DPS 锟斤拷锟斤拷压锟斤拷锟斤拷锟斤拷锟侥ｏ拷
 *   实锟斤拷锟斤拷锟?-0.102 锟斤拷/s 时锟斤拷锟斤拷锟斤拷锟斤拷漂锟斤拷 -6.1 锟斤拷/min锟斤拷锟斤拷 0.5 锟斤拷/s 锟斤拷锟斤拷锟斤拷压锟斤拷
 *   0.18 锟斤拷/min 锟斤拷锟斤拷 锟斤拷锟斤拷 34 锟斤拷锟斤拷锟斤拷锟斤拷锟斤拷锟斤拷锟劫讹拷(|锟斤拷|<0.5锟斤拷/s)锟斤拷锟截断诧拷锟斤拷锟街ｏ拷
 *   一锟斤拷 90锟斤拷 锟斤拷转锟结丢 0.03~0.98锟姐（转锟斤拷越锟斤拷锟斤拷锟斤拷越锟洁，锟斤拷锟斤拷锟斤拷锟斤拷锟劫讹拷时锟戒）锟斤拷
 *   锟斤拷偏锟斤拷锟皆阶硷拷锟斤拷锟斤拷锟斤拷锟斤拷芸锟斤拷锟皆叫★拷锟斤拷锟斤拷锟斤拷失也锟斤拷之锟斤拷小锟斤拷 */
#define YAW_LSB_PER_DPS   16.384f   /* 锟斤拷2000锟斤拷/s 锟斤拷锟教ｏ拷32768/2000 = 16.384 */
#define GYRO_LSB_PER_DPS  YAW_LSB_PER_DPS  /* 锟斤拷锟结共锟斤拷锟斤拷锟斤拷锟斤拷(锟斤拷2000锟斤拷/s)锟斤拷GX/GZ 锟斤拷锟皆伙拷锟斤拷 */
#define YAW_BIAS_DPS      2.41f     /* Z 锟斤拷锟斤拷偏(锟斤拷/s)锟斤拷锟斤拷止实锟斤拷 GZ 锟斤拷值 39.45 LSB / 16.384 */
#define YAW_DEADZONE_DPS  0.5f      /* 锟斤拷锟劫讹拷锟斤拷锟斤拷(锟斤拷/s)锟斤拷压锟狡撅拷止时锟侥伙拷锟斤拷漂锟斤拷 */
#define YAW_DT            0.01f     /* 锟斤拷锟斤拷锟斤拷锟斤拷(s)锟斤拷锟斤拷 10ms 锟斤拷锟狡匡拷一锟斤拷 */
#define YAW_WRAP          1         /* 1=锟斤拷锟姐到 锟斤拷180锟姐；0=锟斤拷锟斤拷锟姐、锟斤拷锟斤拷锟桔硷拷 */
float Yaw = 0.0f;                   /* 偏锟斤拷锟斤拷(锟斤拷)锟斤拷锟斤拷头锟斤拷转为锟斤拷锟斤拷取锟斤拷锟斤拷模锟介安装锟斤拷锟斤拷 */
float YawRate = 0.0f;               /* 偏锟斤拷锟斤拷锟劫讹拷(锟斤拷/s)锟斤拷锟窖匡拷锟斤拷偏锟斤拷锟窖癸拷锟斤拷锟斤拷 */
int16_t LeftPWM, RightPWM;			//锟斤拷PWM锟斤拷锟斤拷PWM
int16_t AvePWM, DifPWM;				//平锟斤拷PWM锟斤拷锟斤拷锟絇WM
int16_t DifPWMTarget = 0;			//转锟斤拷目锟疥（锟斤拷锟劫ｏ拷锟斤拷预锟斤拷锟斤拷
float DifSpeedFilter = 0.0f;		//转锟斤拷锟劫度碉拷通锟剿诧拷值锟斤拷锟剿碉拷锟斤拷锟斤拷锟街诧拷锟劫的讹拷锟斤拷
#define TURN_FF  20.0f						/* 转锟斤拷前锟斤拷锟斤拷锟饺帮拷锟斤拷锟斤拷锟狡筹拷锟斤拷锟?锟斤拷摩锟斤拷锟斤拷锟斤拷锟斤拷锟斤拷锟斤拷 TurnPID 锟斤拷锟斤拷锟斤拷
											 * 没锟斤拷锟斤拷锟斤拷|TurnPID.Out| 小锟斤拷时锟斤拷锟斤拷锟接革拷锟斤拷锟斤拷转锟斤拷转锟津环伙拷"粘住" */
#define TURN_FB_SIGN  (1)    /* 转锟津环凤拷锟斤拷锟斤拷锟脚ｏ拷+1=锟斤拷锟接ｏ拷-1=锟斤拷锟斤拷取锟斤拷锟斤拷锟斤拷锟斤拷锟斤拷装锟斤拷/拧锟竭接凤拷时锟矫ｏ拷
                              * 锟斤拷前值 +1锟斤拷锟斤拷锟斤拷锟斤拷 joystick 锟斤拷支锟斤拷 Target = -RH/50.0 锟斤拷锟斤拷锟阶改的★拷
                              * 锟斤拷锟斤拷锟斤拷锟斤拷锟脚憋拷锟斤拷一锟斤拷锟角ｏ拷锟斤拷锟斤拷锟斤拷锟斤拷
                              *   Target -> DifPWM -> LeftPWM/RightPWM -> 实锟斤拷锟斤拷锟斤拷锟斤拷 -> DifSpeed
                              * 要锟斤拷"Target 锟接达拷"锟斤拷锟斤拷锟斤拷 DifSpeed 也锟斤拷同锟斤拷锟斤拷锟竭ｏ拷锟斤拷锟斤拷锟斤拷锟斤拷锟斤拷锟斤拷锟斤拷锟?
                              * 锟斤拷锟斤拷越锟斤拷越偏锟斤拷一路锟斤拷锟斤拷锟斤拷锟斤拷实锟解发锟斤拷锟斤拷锟斤拷锟斤拷锟斤拷锟斤拷锟窖此达拷锟诫本锟侥硷拷
                              * joystick 锟斤拷 TurnPID.Target 锟侥革拷锟斤拷一锟斤拷取锟斤拷锟斤拷 */

/* ---------- CCD 循锟斤拷锟斤拷锟揭讹拷锟斤拷锟斤拷----------
 * 约锟斤拷锟斤拷TurnPID.Target < 0 = 锟斤拷转锟斤拷锟斤拷 joystick 锟斤拷支锟斤拷全一锟铰★拷
 *   CCD_Zhongzhi > TRACK_CENTER -> 锟斤拷偏锟斤拷"锟斤拷锟斤拷锟斤拷指锟斤拷锟斤拷一锟斤拷" -> Target 取锟斤拷应锟斤拷锟斤拷锟斤拷锟斤拷
 *
 * 默锟斤拷 TrackMode = 0锟斤拷锟较碉拷锟斤拷为锟斤拷只锟斤拷摇锟斤拷时锟斤拷全锟斤拷同锟斤拷锟斤拷锟斤拷锟皆硷拷锟斤拷锟斤拷
 * 锟斤拷锟斤拷锟斤拷锟街凤拷 'T' 锟斤拷 't' 锟脚斤拷锟斤拷循锟斤拷锟斤拷锟劫凤拷一锟斤拷锟剿筹拷锟斤拷
 *
 * 锟斤拷 为什么锟斤拷"锟斤拷锟斤拷偏锟斤拷"锟斤拷锟斤拷锟?目锟斤拷锟斤拷俣锟?锟斤拷锟斤拷锟斤拷直锟接革拷 PWM锟斤拷
 *   循锟斤拷直锟接革拷锟斤拷锟窖撅拷锟斤拷锟矫碉拷转锟斤拷锟斤拷锟斤拷通路锟斤拷Target 锟斤拷 TurnPID锟斤拷锟斤拷锟斤拷 TURN_FF 前锟斤拷锟斤拷锟斤拷
 *   锟斤拷锟斤拷只锟斤拷要一锟斤拷"锟斤拷锟斤拷 -> 转/锟斤拷"锟侥憋拷锟斤拷系锟斤拷锟斤拷锟斤拷锟斤拷锟斤拷维锟斤拷锟节讹拷锟斤拷转锟斤拷 PID锟斤拷 */
#define TRACK_DIR      (-1)     /* 循锟斤拷锟斤拷锟斤拷CCD 锟斤拷 1 锟斤拷锟斤拷锟节筹拷锟斤拷锟斤拷锟绞比?-1锟斤拷装锟斤拷锟斤拷取 +1
                                 * 锟叫据ｏ拷锟斤拷锟竭凤拷锟节达拷锟斤拷锟斤拷锟斤拷锟竭ｏ拷OLED 锟斤拷锟斤拷锟斤拷锟捷筹拷锟斤拷锟斤拷锟斤拷锟绞?
                                 *       TRK 应锟斤拷示锟斤拷值锟斤拷锟斤拷锟斤拷示锟斤拷值锟斤拷锟斤拷锟斤拷锟斤拷锟斤拷欧锟斤拷锟?*/
#define TRACK_GAIN     1.2f     /* 锟斤拷偏(锟斤拷63 锟斤拷锟斤拷)锟斤拷应锟侥诧拷锟斤拷指锟筋：1.2 锟斤拷
                                 *   前锟斤拷 TURN_FF x 1.2 = 24锟斤拷锟斤拷 TurnPID 锟斤拷锟斤拷锟斤拷锟斤拷 30 锟斤拷 54锟斤拷
                                 *   锟斤拷 锟斤拷50 锟斤拷 DifPWM 锟睫凤拷锟斤拷锟斤拷锟斤拷锟斤拷锟斤拷锟劫达拷统锟斤拷诒锟斤拷汀锟斤拷薹锟斤拷锟斤拷锟?*/
#define TRACK_DEAD     2        /* 锟斤拷锟斤拷锟斤拷锟斤拷(锟斤拷锟斤拷)锟斤拷压锟斤拷 CCD_Zhongzhi 锟斤拷 锟斤拷1 锟斤拷锟斤拷锟斤拷锟斤拷锟斤拷锟斤拷 */
#define TRACK_LOST_MAX 25       /* 锟斤拷锟斤拷锟斤拷锟竭讹拷锟斤拷帧锟斤拷锟斤拷锟阶拷锟?5 帧 x 40ms(CCD_Div=4) = 1s */
#define TRACK_SPEED    0.12f    /* 循锟斤拷前锟斤拷锟劫度ｏ拷锟斤拷锟斤拷锟?转/锟诫，直锟斤拷写锟斤拷 SpeedPID.Target
                                 * 锟斤拷 锟斤拷锟斤拷锟斤拷锟絡oystick 锟斤拷支只锟斤拷 !TrackMode 时锟斤拷写 SpeedPID.Target锟斤拷
                                 *   循锟斤拷模式锟斤拷没锟剿革拷锟劫讹拷 -> Target 锟斤拷 0 -> AnglePID.Target 锟斤拷 0
                                 *   -> 锟斤拷只剩锟斤拷锟劫★拷原锟截达拷转锟斤拷锟斤拷前锟斤拷锟斤拷
                                 * 0.08 锟斤拷"锟斤拷锟斤拷锟斤拷锟斤拷"锟斤拷锟斤拷锟睫ｏ拷锟斤拷锟斤拷锟斤拷锟斤拷锟斤拷锟斤拷锟斤拷锟斤拷
                                 *   44锟竭憋拷锟斤拷锟斤拷 x 30锟斤拷锟劫比ｏ拷50ms 锟斤拷锟斤拷 -> 1 锟斤拷锟斤拷 = 0.0152 转/锟诫；
                                 *   AveSpeed 取锟斤拷锟斤拷平锟斤拷 -> 锟斤拷锟斤拷台锟斤拷 0.0076 转/锟诫。
                                 *   0.08 时每 50ms 只锟斤拷 5.3 锟斤拷锟斤拷锟斤拷(锟斤拷锟斤拷 9.4%)锟斤拷锟劫低撅拷锟斤拷锟斤拷锟斤拷锟剿★拷
                                 * 锟金步匡拷锟斤拷锟街ｏ拷ErrorInt 每锟斤拷锟斤拷 Ki*v锟斤拷约 2.3 锟斤拷锟斤拷艿锟?1 锟斤拷锟斤拷牵锟?
                                 *   锟斤拷锟皆从撅拷止锟斤拷锟斤拷锟斤拷锟斤拷锟斤拷约 2 锟斤拷锟?锟斤拷锟斤拷"锟斤拷锟斤拷锟角癸拷锟较★拷
                                 * 锟斤拷锟劫伙拷锟斤拷(锟街撅拷 65mm -> 锟杰筹拷 204mm)锟斤拷0.08 x 204 = 16 mm/s锟斤拷
                                 * 锟斤拷锟斤拷锟?.06 锟斤拷锟斤拷(4.0 锟斤拷锟斤拷/50ms锟斤拷锟斤拷约 3.3 锟斤拷)锟斤拷一锟斤拷一锟劫就加碉拷 0.10 */
#define TRACK_CENTER   56       /* 循锟斤拷锟斤拷悖褐憋拷锟绞?CCD_Zhongzhi 锟侥讹拷锟斤拷
                                 * 为什么锟斤拷锟斤拷 63.5(128 锟斤拷锟截的硷拷锟斤拷锟叫碉拷)锟斤拷
                                 *   锟斤拷头锟斤拷锟斤拷锟较革拷锟斤拷锟斤拷锟酵队帮拷锟斤拷锟斤拷锟阶帮拷锟酵拷亩取锟斤拷诠锟斤拷帧锟?
                                 *   锟斤拷头筒锟节碉拷锟斤拷锟叫固讹拷偏锟筋。实锟斤拷锟斤拷锟节伙拷锟斤拷锟斤拷锟绞憋拷锟斤拷锟?
                                 *   (45+68)/2 = 56锟斤拷偏 7 锟斤拷锟斤拷(纸锟斤拷锟斤拷约 6mm)锟斤拷
                                 *   锟斤拷 56 锟斤拷锟斤拷锟斤拷锟皆帮拷锟解部锟街固讹拷偏锟斤拷直锟接吃碉拷锟斤拷
                                 * 锟疥定锟斤拷锟矫筹拷锟斤拷准直锟竭ｏ拷锟斤拷 OLED 锟较碉拷 CCD_Zhongzhi锟斤拷锟斤拷锟斤拷锟斤拷锟斤拷锟斤拷锟斤拷 */
/* ---------- 直锟斤拷转锟戒：锟斤拷 Yaw 锟斤拷 90 锟斤拷转锟斤拷 ----------
 *
 * 锟斤拷锟斤拷锟斤拷锟斤拷只锟斤拷 90 锟斤拷直锟角★拷直锟角讹拷锟斤拷锟斤拷锟斤拷说锟角革拷"锟斤拷锟?锟斤拷
 *   锟竭匡拷 w = w0 / cos(theta)锟斤拷锟斤拷转 90 锟斤拷时 theta 锟斤拷 0 锟竭碉拷 90锟斤拷w 锟斤拷锟斤拷锟斤拷锟筋。
 *   实锟斤拷(锟竭匡拷 22 锟斤拷锟截★拷锟斤拷锟斤拷约 11.6cm 锟斤拷锟斤拷)锟斤拷锟斤拷锟斤拷锟斤拷锟?22 锟斤拷锟斤拷一锟斤拷锟斤拷锟斤拷约 75 锟斤拷锟截ｏ拷
 *   锟斤拷锟斤拷锟斤拷锟斤拷锟叫碉拷一锟斤拷 锟斤拷锟斤拷 锟斤拷锟斤拷 CCD_Lost = 1锟斤拷锟斤拷锟解不锟斤拷"没锟斤拷"锟斤拷锟斤拷"直锟斤拷"锟斤拷
 *
 * 锟斤拷锟斤拷锟叫据诧拷锟斤拷锟斤拷"锟斤拷锟斤拷没锟斤拷"锟斤拷锟角分诧拷锟斤拷直锟角★拷锟窖轨、锟酵凤拷锟斤拷锟斤拷锟斤拷锟斤拷锟斤拷 80cm 锟斤拷锟斤拷锟斤拷锟斤拷锟?
 * 锟斤拷锟斤拷锟斤拷锟叫撅拷锟角猴拷锟斤拷锟斤拷"锟斤拷锟斤拷锟斤拷状"锟斤拷
 *
 *     直锟斤拷      锟斤拷锟剿讹拷锟阶ｏ拷锟斤拷锟斤拷锟斤拷 22        -> 锟斤拷锟斤拷
 *     直锟斤拷      一锟剿帮拷一锟剿黑ｏ拷锟斤拷锟斤拷锟斤拷 75    -> 锟斤拷
 *     锟窖癸拷/锟斤拷锟斤拷 锟斤拷锟剿讹拷锟阶ｏ拷锟斤拷锟斤拷锟斤拷 0         -> 锟斤拷锟姐（锟斤拷锟斤拷锟斤拷诜锟斤拷锟斤拷锟狡撅拷锟阶?90 锟饺ｏ拷
 *     锟斤拷头全锟斤拷  锟斤拷锟剿讹拷锟斤拷                   -> 锟斤拷锟姐（锟斤拷锟斤拷锟斤拷冒锟斤拷锟斤拷懦锟斤拷锟?
 *
 * 锟斤拷锟斤拷锟街憋拷锟斤拷锟?PWM锟斤拷锟斤拷锟斤拷写 TurnPID.Target 锟斤拷锟斤拷 锟斤拷锟斤拷锟窖撅拷锟斤拷锟矫碉拷转锟津环ｏ拷
 * 锟斤拷锟斤拷转锟斤拷时锟斤拷锟斤拷锟街诧拷锟斤拷锟斤拷然锟缴憋拷锟斤拷锟斤拷锟秸伙拷锟斤拷锟斤拷氐锟窖癸拷陆锟斤拷锟斤拷锟斤拷哟蚧锟斤拷锟斤拷谋锟阶拷恰锟?
 * Yaw 只锟斤拷锟斤拷锟斤拷"什么时锟斤拷停"(|锟桔硷拷转锟斤拷| >= 90 锟斤拷)锟斤拷锟斤拷锟斤拷锟斤拷锟斤拷疲锟斤拷锟斤拷圆锟斤拷玫锟斤拷锟斤拷妗?
 */
#define CCD_EDGE_LO        3        /* 锟斤拷锟斤拷锟斤拷锟饺★拷锟斤拷悖拷芸锟斤拷锟斤拷锟洁几锟斤拷锟斤拷锟斤拷失锟斤拷锟斤拷锟斤拷兀锟?*/
#define CCD_EDGE_HI        124      /* 锟斤拷锟斤拷锟揭讹拷取锟斤拷锟斤拷 */
#define CORNER_MIN_DARK    40       /* 直锟斤拷帧锟斤拷锟斤拷锟劫猴拷锟斤拷锟斤拷锟斤拷锟斤拷直锟斤拷 22锟斤拷直锟斤拷 75锟斤拷取锟斤拷 */
#define CORNER_CONFIRM     2        /* 锟斤拷锟斤拷锟斤拷帧锟斤拷锟斤拷直锟斤拷锟斤拷锟斤拷锟斤拷锟斤拷锟剿ｏ拷2 帧 = 80ms锟斤拷 */
#define PIVOT_RATE         2.0f     /* 转锟斤拷时写锟斤拷 TurnPID.Target 锟侥诧拷锟斤拷指锟筋。
                                     *   锟斤拷位锟斤拷 TRACK_GAIN 锟斤拷锟斤拷锟揭伙拷拢锟斤拷锟狡?63 锟斤拷锟斤拷)=1.2锟斤拷
                                     *   1.5 锟斤拷锟斤拷偏锟斤拷 25%锟斤拷锟斤拷锟?TURN_FF=20 锟矫碉拷约 30 锟斤拷前锟斤拷锟斤拷锟斤拷
                                     *   转锟斤拷锟斤拷锟酵加达拷甩尾/锟津滑就硷拷小锟斤拷 */
#define PIVOT_DEG          90.0f    /* 目锟斤拷转锟斤拷(锟斤拷) */
#define PIVOT_TIMEOUT_MS   3000     /* 转锟戒超时锟斤拷锟斤拷锟斤拷锟斤拷锟届常/锟斤拷锟斤拷住时锟斤拷锟斤拷 */
#define PIVOT_ADVANCE_MS   0        /* 锟较筹拷直锟角猴拷"锟斤拷直锟叫讹拷锟斤拷 ms"锟劫匡拷始转锟斤拷
                                     *
                                     * 为什么锟斤拷要锟斤拷锟斤拷锟斤拷锟斤拷锟紺CD 装锟斤拷锟斤拷锟斤拷前锟斤拷约 L 锟斤拷锟阶ｏ拷锟斤拷锟斤拷锟斤拷
                                     * 锟斤拷锟斤拷锟斤拷原锟斤拷转锟斤拷 锟斤拷锟斤拷 锟斤拷锟斤拷锟斤拷锟竭碉拷锟角半径 L 锟斤拷圆锟斤拷锟斤拷
                                     * 锟斤拷锟斤拷"锟斤拷锟斤拷锟斤拷锟秸匡拷锟斤拷直锟斤拷"锟斤拷一瞬锟斤拷锟阶?90 锟饺ｏ拷转锟疥传锟斤拷锟斤拷
                                     * 锟斤拷停锟斤拷锟斤拷锟斤拷锟斤拷约 L 锟斤拷锟阶达拷锟斤拷锟斤拷锟斤拷锟斤拷锟斤拷锟斤拷锟竭癸拷系锟斤拷锟斤拷转也追锟斤拷锟较ｏ拷锟斤拷
                                     *     L <= 4 锟斤拷锟斤拷   -> 锟斤拷锟斤拷锟斤拷锟叫憋拷缘锟节ｏ拷循锟斤拷锟杰帮拷锟斤拷锟斤拷锟斤拷锟斤拷
                                     *     L >  5.8 锟斤拷锟斤拷 -> 锟斤拷全锟斤拷锟斤拷野锟斤拷SETTLE 锟斤拷锟斤拷远锟饺诧拷锟斤拷锟斤拷
                                     * 锟斤拷时锟斤拷要锟斤拷直锟斤拷 (L+1) 锟斤拷锟阶ｏ拷锟斤拷锟斤拷锟斤拷压锟斤拷转锟斤拷锟较ｏ拷
                                     * 转锟疥传锟斤拷锟斤拷锟斤拷锟斤拷压住锟斤拷锟斤拷 锟斤拷锟斤拷 锟斤拷锟角达拷锟斤拷锟轿ｏ拷锟斤拷锟角碉拷锟斤拷锟斤拷锟侥★拷
                                     *
                                     * 锟斤拷锟姐：TRACK_SPEED=0.12 转/锟斤拷 x 204mm 锟杰筹拷 = 24mm/s锟斤拷
                                     *       1 锟斤拷锟斤拷约 420ms锟斤拷锟斤拷锟斤拷锟斤拷 L(锟斤拷锟斤拷) x 420 锟斤拷锟诫。
                                     * 锟疥定锟斤拷锟矫筹拷锟斤拷锟斤拷锟斤拷锟斤拷锟侥碉拷 CCD 锟斤拷头锟侥撅拷锟斤拷 L锟斤拷
                                     * 锟斤拷锟斤拷 0 锟皆ｏ拷转锟斤拷锟斤拷锟皆硷拷锟揭伙拷锟斤拷锟酵诧拷锟矫管ｏ拷锟揭诧拷锟斤拷锟酵帮拷锟斤拷式锟筋。 */
#define SETTLE_OK_FRAMES   2        /* 转锟斤拷锟斤拷锟斤拷锟斤拷锟街★拷锟斤拷锟斤拷戏锟较革拷卟锟斤拷锟斤拷一锟斤拷锟?*/
#define SETTLE_TIMEOUT_MS  2000     /* 锟揭伙拷锟竭筹拷时 */

#define CORNER_LINE        0u       /* 锟斤拷锟斤拷循锟斤拷 */
#define CORNER_PIVOT       1u       /* 锟斤拷锟节帮拷 Yaw 转 90 锟斤拷 */
#define CORNER_SETTLE      2u       /* 转锟斤拷锟剿ｏ拷直锟叫碉拷锟竭伙拷锟斤拷 */

volatile uint8_t TrackMode    = 0;  /* 0 = 摇锟斤拷转锟斤拷1 = CCD 循锟斤拷锟斤拷'T'/'t' 锟叫伙拷锟斤拷 */
volatile uint8_t TrackLostCnt = 0;  /* 锟斤拷锟斤拷锟斤拷锟斤拷帧锟斤拷锟斤拷 */

volatile uint8_t CornerState = CORNER_LINE;
volatile int8_t  CornerDir   = 0;   /* +1 = 锟斤拷锟斤拷位锟斤拷转锟斤拷-1 = 锟斤拷锟斤拷位锟斤拷转 */
volatile float   YawTurned   = 0.0f;/* 锟斤拷锟斤拷转锟斤拷锟桔硷拷转锟斤拷(锟斤拷)锟斤拷锟斤拷锟斤拷锟桔硷拷锟叫凤拷锟斤拷锟斤拷锟斤拷 */
float    YawPrev     = 0.0f;        /* 锟斤拷一锟侥碉拷 Yaw锟斤拷锟斤拷锟斤拷锟斤拷锟斤拷锟斤拷 */
uint16_t PivotTicks  = 0;           /* 转锟斤拷锟窖筹拷锟斤拷(ms) */
uint16_t SettleTicks = 0;           /* SETTLE 锟窖筹拷锟斤拷(ms) */
uint8_t  CornerSeen  = 0;           /* 锟斤拷锟斤拷直锟斤拷帧锟斤拷锟斤拷 */
uint8_t  SettleOk    = 0;           /* SETTLE 锟斤拷锟斤拷锟斤拷锟较凤拷帧锟斤拷锟斤拷 */

/* ---------- 锟斤拷锟斤拷锟斤拷(Self-Erect)锟斤拷锟斤拷 ---------- */
#define ERECT_PWM        100		/* 甩锟斤拷PWM(0~100)锟斤拷锟斤拷锟斤拷锟揭达拷太锟酵伙拷甩锟斤拷头锟斤拷锟斤拷锟斤拷锟斤拷锟?*/
#define ERECT_START_ANG  55.0f	/* 平锟斤拷锟斤拷 |Angle| 锟斤拷锟斤拷锟斤拷值 -> 锟叫讹拷摔锟斤拷锟斤拷锟斤拷锟斤拷锟斤拷锟斤拷锟斤拷 */
#define ERECT_DONE_ANG   30.0f	/* 前锟斤拷锟斤拷锟斤拷|Angle| 锟秸斤拷锟剿达拷锟斤拷 -> 锟斤拷锟斤拷平锟解环 */
#define ERECT_DONE_ANG_BACK 45.0f	/* 锟襟倒凤拷锟津：猴拷锟斤拷锟斤拷抬锟斤拷锟脚匡拷锟剿角度就斤拷锟斤拷平锟解环 */
#define ERECT_TIMEOUT_MS 3000	/* 甩锟街筹拷锟斤拷锟斤拷时锟戒还没锟斤拷锟斤拷 -> 停锟斤拷锟斤拷路锟斤拷太锟斤拷 / 锟斤拷锟斤拷住锟斤拷 */
#define ERECT_ABORT_GUARD_MS 300	/* 起立中按键生效门槛(ms)：ErectTime 到了才允许"放弃起立" */
uint16_t ErectTime = 0;			/* 锟斤拷前 ERECT 锟窖筹拷锟斤拷(ms)锟斤拷每 10ms 锟斤拷一锟轿ｏ拷同时锟斤拷锟斤拷 LED 锟斤拷烁 */
#define ERECT_DIR        (1)		/* 甩锟街凤拷锟斤拷1=锟斤拷平锟解环同锟斤拷(默锟斤拷)锟斤拷-1=取锟斤拷(原锟斤拷转圈/磨锟斤拷胎时锟斤拷 -1) */
#define ERECT_PULSE_MS   400			/* 锟斤拷锟斤拷模式锟斤拷每锟斤拷锟斤拷锟斤拷通锟斤拷时锟斤拷(ms)锟斤拷0=锟斤拷锟斤拷通锟斤拷(一直甩) */
#define ERECT_PERIOD_MS  500		/* 锟斤拷锟斤拷锟斤拷锟斤拷(ms)锟斤拷通锟斤拷 400ms + 锟较碉拷 100ms */
static uint16_t Count2 = 0;			//转锟斤拷10ms锟斤拷锟斤拷锟斤拷锟斤拷前未使锟矫ｏ拷
float LeftSpeed, RightSpeed;		//锟斤拷锟斤拷锟劫度ｏ拷锟斤拷锟斤拷锟劫度ｏ拷锟斤拷锟斤拷锟?转/锟诫）
float AveSpeed, DifSpeed;			//平锟斤拷锟劫度ｏ拷锟斤拷锟斤拷俣锟?

float G = 0.00;						//锟斤拷锟劫度计角讹拷锟斤拷锟狡拷锟?锟斤拷)锟斤拷锟斤拷械锟斤拷装锟斤拷斜锟侥诧拷锟斤拷锟斤拷锟斤拷锟斤拷锟斤拷锟斤拷锟斤拷锟斤拷锟斤拷锟竭碉拷

/* ---------- 锟斤拷锟斤拷 PID 锟结构锟藉：锟斤拷锟斤拷时同时锟斤拷锟斤拷员锟斤拷锟斤拷值 ----------
 * 注锟斤拷 PID_Update() 锟斤拷锟斤拷锟斤拷锟斤拷锟皆ｏ拷锟斤拷 pid.c锟斤拷锟斤拷
 *   1) Ki==0 时锟斤拷锟斤拷锟筋被强锟斤拷锟斤拷锟斤拷 锟斤拷锟斤拷 锟斤拷锟斤拷"锟饺关伙拷锟街碉拷锟斤拷"锟角帮拷全锟斤拷
 *   2) 锟斤拷微锟斤拷锟斤拷锟叫ｏ拷Out 锟斤拷锟轿拷锟斤拷锟斤拷锟斤拷锟斤拷锟?(Actual - Actual1) 锟较ｏ拷锟斤拷锟斤拷锟斤拷锟斤拷睿?
 *      锟斤拷锟皆革拷 Target 锟斤拷锟斤拷锟斤拷锟轿拷殖锟斤拷 */
PID_t AnglePID =  					//锟角度伙拷锟斤拷直锟斤拷锟斤拷锟斤拷锟斤拷锟斤拷锟斤拷 Angle锟斤拷锟斤拷锟?AvePWM锟斤拷锟斤拷锟斤拷锟结构锟斤拷锟节伙拷
{
    .Kp = 16.9,						//锟斤拷锟斤拷锟斤拷权锟斤拷
    .Ki = 0.06,						//锟斤拷锟斤拷锟斤拷权锟斤拷
    .Kd = 30.4,						//微锟斤拷锟斤拷权锟斤拷

    .OutMax = 80,					//锟斤拷锟斤拷薹锟斤拷锟斤拷锟?-> 锟斤拷锟?PWM 80
    .OutMin = -80,					//锟斤拷锟斤拷薹锟斤拷锟斤拷锟?
	
	.OutOffset = 0,					//锟斤拷锟斤拷锟斤拷锟斤拷锟斤拷锟斤拷锟絆ut>0 时锟接★拷Out<0 时锟斤拷锟斤拷锟斤拷锟斤拷锟狡匡拷锟斤拷锟斤拷锟侥︼拷锟?
	
	.ErrorIntMax = 600,				//锟斤拷锟斤拷锟睫凤拷锟斤拷锟睫ｏ拷锟斤拷锟斤拷锟街憋拷锟酵ｏ拷
	.ErrorIntMin = -600,			//锟斤拷锟斤拷锟睫凤拷锟斤拷锟斤拷

};
PID_t SpeedPID =  					//锟劫度伙拷锟斤拷锟斤拷锟斤拷 AveSpeed(转/锟斤拷)锟斤拷锟斤拷锟?AnglePID.Target(锟角讹拷锟铰达拷锟斤拷)
{
    .Kp = 2.7,						//锟斤拷锟斤拷锟斤拷权锟斤拷
    .Ki = 0.21,						//锟斤拷锟斤拷锟斤拷权锟斤拷
    .Kd = 0,						//微锟斤拷锟斤拷权锟斤拷

    .OutMax = 5,					//锟斤拷锟斤拷薹锟?锟斤拷5锟姐：锟斤拷锟斤拷直锟斤拷目锟斤拷锟斤拷锟斤拷锟斤拷斜锟角ｏ拷锟斤拷前 锟斤拷5锟斤拷锟饺筹拷锟斤拷 锟斤拷10 锟斤拷锟斤拷锟截ｏ拷
    .OutMin = -5,					
	
	.ErrorIntMax = 150,				//锟斤拷锟斤拷锟睫凤拷锟斤拷锟斤拷
	.ErrorIntMin = -150,			//锟斤拷锟斤拷锟睫凤拷锟斤拷锟斤拷

};
PID_t TurnPID =  					//转锟津环ｏ拷锟斤拷锟斤拷锟斤拷锟斤拷锟街诧拷锟劫ｏ拷锟斤拷锟?DifPWM
{
    .Kp = 5.9,						//锟斤拷锟斤拷锟斤拷权锟斤拷
    .Ki = 0,						//锟斤拷锟斤拷锟斤拷权锟截ｏ拷Ki=0 -> 锟斤拷锟斤拷锟皆讹拷锟斤拷锟姐，锟斤拷锟斤拷锟斤拷锟斤拷锟狡ｏ拷
    .Kd = 0,						//微锟斤拷锟斤拷权锟斤拷

    .OutMax = 30,					//锟斤拷锟斤拷薹锟?锟斤拷30
    .OutMin = -30,					
	
	.ErrorIntMax = 20,				//锟斤拷锟斤拷锟睫凤拷锟斤拷锟斤拷
	.ErrorIntMin = -20,				//锟斤拷锟斤拷锟睫凤拷锟斤拷锟斤拷

};

/* ==========================================================================
 * PID 状态锟斤拷位 / 锟角讹拷锟截讹拷准
 *
 * PID_ResetAll()锟斤拷锟斤拷锟斤拷锟斤拷 PID 锟斤拷 Target / Out / 锟斤拷锟斤拷 / 锟斤拷锟饺拷锟斤拷锟斤拷悖拷锟?预锟斤拷锟较达拷值"
 *   为锟斤拷前锟斤拷锟斤拷值锟斤拷锟斤拷止微锟斤拷锟斤拷锟节革拷位锟斤拷牡锟揭伙拷牟锟斤拷锟斤拷薮锟斤拷锟斤拷锟?
 *   摔锟斤拷(StopCar)锟斤拷锟斤拷停("0")锟斤拷锟斤拷锟斤拷锟斤拷时锟斤拷锟结经锟斤拷 StopCar()锟斤拷锟斤拷锟皆讹拷锟斤拷锟竭碉拷锟斤拷锟斤。
 *   锟节诧拷只锟叫革拷值锟斤拷锟睫猴拷时锟斤拷锟斤拷锟斤拷锟斤拷丝锟斤拷源锟?1ms 锟叫讹拷锟斤安全锟斤拷锟矫★拷
 *
 * Angle_Realign()锟斤拷锟矫硷拷锟劫度计把角讹拷锟斤拷锟铰讹拷准一锟轿ｏ拷锟斤拷锟斤拷止时锟斤拷效锟斤拷锟斤拷
 *   锟斤拷锟斤拷锟剿诧拷 Alpha=0.001 锟斤拷时锟戒常锟斤拷约 10s锟斤拷摔锟斤拷锟斤拷锟斤拷锟皆硷拷锟斤拷锟斤拷太锟斤拷锟斤拷
 *   锟斤拷锟斤拷锟斤拷锟斤拷前锟斤拷锟斤拷锟截讹拷准一锟斤拷 锟斤拷锟斤拷 取 300ms 锟斤拷锟劫度计角碉拷平锟斤拷锟斤拷
 *
 *   锟斤拷 锟节诧拷锟斤拷 30 锟斤拷 HAL_Delay(10ms) = 300ms 锟斤拷锟斤拷锟斤拷锟饺达拷锟斤拷只锟杰凤拷锟斤拷循锟斤拷锟斤拷锟矫ｏ拷
 *     锟斤拷锟皆诧拷锟杰放斤拷 1ms 锟斤拷 HAL_TIM_PeriodElapsedCallback锟斤拷
 *   锟斤拷 锟饺达拷锟节硷拷锟斤拷锟截碉拷 TIM3 锟叫断ｏ拷锟叫讹拷锟斤拷也锟斤拷锟?MPU6050锟斤拷同一锟斤拷 I2C锟斤拷锟斤拷
 *     锟斤拷锟竭诧拷锟斤拷锟结互锟斤拷锟狡伙拷时锟斤拷锟斤拷锟斤拷只锟斤拷 DIER 锟斤拷 UIE 位锟斤拷锟斤拷锟斤拷锟斤拷锟斤拷状态锟斤拷
 *     锟斤拷锟斤拷锟襟按斤拷锟斤拷前锟斤拷原状锟街革拷锟斤拷
 * ========================================================================== */
void PID_ResetAll(void)
{
    PID_Init(&AnglePID);
    PID_Init(&SpeedPID);
    PID_Init(&TurnPID);

    /* 预锟斤拷"锟较达拷值"锟斤拷锟斤拷止微锟斤拷锟斤拷锟揭伙拷某锟斤拷 */
    AnglePID.Actual  = Angle;
    AnglePID.Actual1 = Angle;
    AnglePID.Error0  = AnglePID.Target - AnglePID.Actual;
    AnglePID.Error1  = AnglePID.Error0;

    SpeedPID.Actual  = AveSpeed;
    SpeedPID.Actual1 = AveSpeed;
    TurnPID.Actual   = DifSpeed;
    TurnPID.Actual1  = DifSpeed;

    DifSpeedFilter = DifSpeed;
    DifPWM         = 0;

    /* 直锟斤拷转锟斤拷状态一锟斤拷位锟斤拷摔锟斤拷/锟斤拷停/锟斤拷锟斤拷锟斤拷锟结经锟斤拷锟斤拷锟斤。
     * 锟斤拷锟斤拷锟劫凤拷 "1" 时锟斤拷锟杰达拷锟斤拷一锟轿碉拷 PIVOT 状态锟斤拷锟较ｏ拷凭锟斤拷转一锟斤拷 90 锟饺★拷 */
    CornerState    = CORNER_LINE;
    CornerDir      = 0;
    CornerSeen     = 0;
    YawTurned      = 0.0f;
    PivotTicks     = 0;
    SettleTicks    = 0;
    SettleOk       = 0;
}

void Angle_Realign(void)
{
    int32_t  sum = 0;
    int      k;
    uint32_t itWasOn;

    /* 锟斤拷锟斤拷锟节硷拷要锟斤拷锟斤拷 TIM3 锟叫断ｏ拷锟叫讹拷锟斤拷也锟斤拷锟?MPU6050(同一锟斤拷 I2C)锟斤拷
     * 锟斤拷锟竭诧拷锟斤拷锟结互锟斤拷锟狡伙拷时锟斤拷锟斤拷锟斤拷只锟斤拷 DIER 锟斤拷 UIE 位锟斤拷锟斤拷锟斤拷锟斤拷锟斤拷状态锟斤拷
     * 锟斤拷锟斤拷锟襟按斤拷锟斤拷前锟斤拷原状锟街革拷锟斤拷锟斤拷锟斤拷锟较碉拷锟绞硷拷锟斤拷锟斤拷锟斤拷锟斤拷械锟斤拷枚锟斤拷锟斤拷茫锟斤拷锟?*/
    itWasOn = (htim3.Instance->DIER & TIM_IT_UPDATE) ? 1u : 0u;
    __HAL_TIM_DISABLE_IT(&htim3, TIM_IT_UPDATE);

    for (k = 0; k < 30; k++)              /* 30 x 10ms = 300ms */
    {
        MPU6050_GetData(&AX, &AY, &AZ, &GX, &GY, &GZ);
        sum += (int32_t)(-atan2(AY, AZ) / 3.14159 * 180.0);
        HAL_Delay(10);
    }

    Angle = (float)sum / 30.0f + G;       /* 取平锟斤拷锟斤拷锟斤拷锟斤拷锟接伙拷械锟斤拷锟狡拷锟?*/

    if (itWasOn)
    {
        __HAL_TIM_CLEAR_IT(&htim3, TIM_IT_UPDATE);
        __HAL_TIM_ENABLE_IT(&htim3, TIM_IT_UPDATE);
    }
}

/* ==========================================================================
 * 状态迁锟狡接口ｏ拷StartErect() / StopCar()
 *   StartErect() 只锟斤拷锟斤拷循锟斤拷锟斤拷锟矫ｏ拷锟节诧拷锟斤拷锟斤拷 300ms 锟斤拷锟角讹拷锟截讹拷准锟斤拷
 *   StopCar()    锟斤拷循锟斤拷锟斤拷 10ms 锟叫断讹拷锟斤拷锟斤拷茫锟斤拷锟斤拷锟街伙拷锟斤拷锟街?+ PID 锟斤拷位 + GPIO 写锟斤拷
 *                锟斤拷些锟斤拷锟叫讹拷锟斤都锟角帮拷全锟斤拷
 *   CarState 锟斤拷锟街节ｏ拷锟叫讹拷只锟结看锟斤拷"锟斤拷状态"锟斤拷"锟斤拷状态锟斤拷写锟斤拷"锟斤拷锟斤拷锟斤拷要锟劫斤拷锟斤拷
 * ========================================================================== */
void StopCar(void)
{
    CarState  = ST_IDLE;
    /* 停车 = 循迹一并关闭。
     * 不写这两句的话，摔车（平衡环里 |Angle| 超限）自动 StopCar 之后
     * TrackMode 仍然是 1，会留下两个后果：
     *   1) 主循环处理摇杆那两支被 if (!TrackMode) 挡住，车已经回到 IDLE，
     *      却既改不了前进速度也转不了向；
     *   2) 下次按键起立会带着循迹直接进 BALANCE，车一立起来就自己冲出去。 */
    TrackMode    = 0;
    TrackLostCnt = 0;
    ErectTime = 0;
    PID_ResetAll();               /* 摔锟斤拷/锟斤拷停/锟斤拷时锟斤拷锟斤拷锟斤拷锟叫伙拷锟斤拷锟节诧拷状态一锟斤拷锟斤拷删锟?*/
    TB6612_setPWM(1, 0);          /* 停锟斤拷PWM=0锟斤拷IN1/IN2 同时为锟斤拷 -> 锟斤拷锟斤拷锟斤拷锟酵Ｗ?*/
    TB6612_setPWM(2, 0);
}

void StartErect(void)
{
    if (CarState != ST_IDLE)
    {
        return;                   /* 锟斤拷锟斤拷锟斤拷锟叫就猴拷锟皆ｏ拷锟截革拷锟秸碉拷 "1" 锟斤拷锟斤拷锟斤拷锟斤拷 */
    }

    /* 锟斤拷锟截讹拷准锟角度ｏ拷锟劫斤拷锟斤拷锟斤拷锟斤拷摔锟斤拷锟襟互诧拷锟剿诧拷要十锟斤拷锟斤拷锟斤拷锟斤拷锟斤拷锟?
     * 锟斤拷锟斤拷锟斤拷锟酵伙拷锟斤拷糯锟侥筹拷始锟角讹拷去甩锟街★拷300ms 锟斤拷锟斤拷锟斤拷只锟斤拷锟斤拷循锟斤拷锟斤拷锟矫★拷 */
    Angle_Realign();

    PID_ResetAll();
    ErectTime = 0;

    CarState = ST_ERECT;          /* 锟斤拷锟揭伙拷锟斤拷锟斤拷锟斤拷卸峡锟绞硷拷庸锟?*/
}

/* ==========================================================================
 * PA5 用户按键：EXTI5 下降沿 -> 启动 / 停止 切换
 *
 * 分工（关键）：
 *   中断回调 只置 KeyFlag 就返回，耗时 < 2us，不碰电机、不读 I2C。
 *   主循环   消费 KeyFlag，再调 StartErect() / StopCar()。
 *
 * 为什么不能在中断里直接调 StartErect()：
 *   它内部 Angle_Realign() 有 300ms 阻塞（读 MPU6050，期间关掉 TIM3 中断），
 *   放进 ISR 会让 10ms 平衡节拍停摆 300ms，正在直立行驶的车会当场倒下。
 *
 * 消抖：机械按键抖动 5~20ms，窗口内重复边沿只认第一次。
 *       EXTI5 优先级 0（与 TIM1/TIM3 同级），所以 ISR 越短越好。
 * ========================================================================== */
#define KEY_DEBOUNCE_MS   50      /* 按键软消抖窗口(ms) */

volatile uint8_t KeyFlag = 0;     /* 1 = 有一次有效按键；主循环消费后清零 */

void HAL_GPIO_EXTI_Callback(uint16_t GPIO_Pin)
{
    static uint32_t KeyTick = 0;
    uint32_t now;

    if (GPIO_Pin != GPIO_PIN_5)
    {
        return;                   /* 本工程目前只有 PA5 走 EXTI */
    }

    now = HAL_GetTick();
    if ((uint32_t)(now - KeyTick) >= KEY_DEBOUNCE_MS)
    {
        KeyTick = now;
        KeyFlag = 1;
    }
}
static const char *StateStr(void)
{
    if (CarState == ST_BALANCE) return "BAL";
    if (CarState == ST_ERECT)   return "ERECT";
    return "IDLE";
}

/* ==========================================================================
 * TIM3 锟斤拷锟斤拷锟叫断ｏ拷锟斤拷锟斤拷系统锟斤拷唯一时锟斤拷锟斤拷10ms锟斤拷
 *   tim.c: Prescaler = 72-1, Period = 10000-1  ->  72MHz/72/10000 = 10ms
 *
 * 锟斤拷锟侥凤拷锟斤拷锟姐（锟斤拷频值锟斤拷锟侥硷拷锟较凤拷 TICK_10MS / TICK_50MS 锟斤拷锟斤拷锟疥）锟斤拷
 *   每 1 锟斤拷    hcount++锟斤拷锟斤拷锟斤拷末尾锟斤拷锟斤拷欠锟剿わ拷锟?
 *   每 10ms    锟斤拷 MPU6050 -> 锟斤拷态锟斤拷锟斤拷 -> 偏锟斤拷锟斤拷锟斤拷 -> 直锟斤拷锟斤拷 / 锟斤拷锟斤拷锟斤拷
 *   每 50ms    锟斤拷锟斤拷锟斤拷锟斤拷 -> 锟斤拷锟劫讹拷 -> 锟劫度伙拷 + 转锟斤拷
 *   每 1 锟斤拷末  锟斤拷 CCD_Div 锟斤拷频锟斤拷一帧 CCD锟斤拷约 0.7ms锟斤拷
 *
 * 时锟斤拷预锟姐（一锟斤拷 = 10ms锟斤拷锟斤拷
 *   MPU6050 一锟斤拷 I2C 突锟斤拷锟斤拷     ~150us
 *   锟斤拷态锟斤拷锟斤拷 + 锟斤拷态锟斤拷锟狡凤拷锟斤拷      ~70us
 *   CCD 一帧锟斤拷锟斤拷 1/CCD_Div 锟侥ｏ拷  ~700us  -> 锟斤拷 CCD_Div=4 摊锟斤拷约 175us
 *   锟较硷拷                         ~520us / 10ms 锟斤拷 5.2%
 *   锟筋坏锟斤拷锟侥ｏ拷锟斤拷锟矫革拷锟较诧拷 CCD锟斤拷    ~1.0ms = 10%锟斤拷锟斤拷然锟斤拷裕锟斤拷
 * ========================================================================== */
void HAL_TIM_PeriodElapsedCallback(TIM_HandleTypeDef *htim)
{
    if (htim != &htim3)
    {
        return;
    }

    hcount++;
    __HAL_TIM_CLEAR_IT(&htim3, TIM_IT_UPDATE);

    if (hcount >= TICK_10MS)                          /* ===== 10ms 锟斤拷 ===== */
    {
        hcount = 0;
        MPU6050_GetData(&AX, &AY, &AZ, &GX, &GY, &GZ);   /* 一锟斤拷 I2C 突锟斤拷锟斤拷 14 锟街节ｏ拷约 150us */
        /* 锟斤拷锟斤拷 X 锟斤拷锟斤拷偏锟斤拷+10 LSB 锟斤拷 0.61锟斤拷/s锟斤拷锟斤拷实锟斤拷硬锟斤拷锟侥固讹拷偏锟斤拷 */
        GX += 10;

        /* 锟斤拷锟劫度计角度ｏ拷atan2 锟斤拷锟斤拷锟斤拷龋锟阶拷山嵌龋锟紾 锟角伙拷械锟斤拷锟狡拷锟?*/
        AngleAcc = -atan2(AY, AZ) / 3.14159 * 180 + G;

        /* 锟斤拷锟斤拷锟剿诧拷 Alpha=0.001锟斤拷
         *   锟斤拷锟劫度计筹拷锟斤拷准锟斤拷锟斤拷锟斤拷锟今动ｏ拷锟斤拷锟竭硷拷锟劫讹拷锟斤拷锟叫ｏ拷
         *   锟斤拷锟捷伙拷锟街讹拷锟斤拷准锟斤拷锟斤拷漂
         *   时锟戒常锟斤拷 锟斤拷 1/(Alpha * 100Hz) = 10s锟斤拷锟斤拷 10s 锟斤拷锟斤拷锟斤拷锟捷ｏ拷锟斤拷锟斤拷锟脚硷拷锟劫度硷拷
         * 锟斤拷锟斤拷预锟斤拷锟斤拷募锟斤拷锟斤拷锟斤拷锟?Angle 锟侥凤拷锟斤拷约锟斤拷锟斤拷-atan2(AY,AZ)锟斤拷锟斤拷锟斤拷 GX 锟斤拷锟斤拷锟斤拷锟洁反锟斤拷
         * dt 直锟斤拷写 0.01 锟斤拷锟斤拷锟矫憋拷锟斤拷锟斤拷锟斤拷锟斤拷锟斤拷呛愣?10ms 锟斤拷锟节★拷 */
        AngleGyro = Angle - GX / 32768.0 * 2000 * 0.01;
        float Alpha = 0.001f;
        Angle = Alpha * AngleAcc + (1 - Alpha) * AngleGyro;

        /* ---------- 偏锟斤拷锟角ｏ拷Z 锟斤拷锟斤拷锟捷伙拷锟斤拷 ----------
         * 锟斤拷取锟斤拷锟狡拷锟斤拷锟斤拷锟斤拷锟絛t 锟斤拷取值锟斤拷锟缴硷拷锟侥硷拷锟较凤拷 YAW_* 锟疥定锟藉处锟斤拷注锟酵★拷
         * 锟斤拷慰锟斤拷锟斤拷痰锟斤拷锟斤拷锟斤拷丶锟斤拷锟斤拷欤?
         *   1) 锟斤拷锟斤拷锟斤拷 GYRO_CONFIG=0x18(锟斤拷2000锟斤拷/s) 锟斤拷 16.384 LSB/(锟斤拷/s)锟斤拷
         *      锟轿匡拷锟斤拷锟斤拷锟斤拷 0x00(锟斤拷250锟斤拷/s) 锟斤拷 131锟斤拷锟秸筹拷锟斤拷锟斤拷偏锟斤拷锟角诧拷 8 锟斤拷
         *   2) dt 锟教讹拷 0.01f锟斤拷锟斤拷锟斤拷 HAL_GetTick() 锟斤拷 1ms 锟街憋拷锟斤拷去锟斤拷 */
        YawRate = GZ / YAW_LSB_PER_DPS - YAW_BIAS_DPS;
        if (YawRate > -YAW_DEADZONE_DPS && YawRate < YAW_DEADZONE_DPS) YawRate = 0.0f;
        Yaw += YawRate * YAW_DT;
#if YAW_WRAP
        if      (Yaw >  180.0f) Yaw -= 360.0f;
        else if (Yaw < -180.0f) Yaw += 360.0f;
#endif

        /* ---------- 偏锟斤拷锟斤拷锟斤拷锟桔硷拷 + 直锟斤拷转锟斤拷锟斤拷锟斤拷锟叫撅拷 ----------
         * Yaw 每锟侥癸拷锟姐到 锟斤拷180 锟饺ｏ拷锟斤拷锟皆诧拷锟斤拷直锟斤拷锟斤拷 |Yaw - 转锟斤拷锟斤拷锟絴锟斤拷
         * 锟斤拷锟?179 锟斤拷锟斤拷锟斤拷转 90 锟饺伙拷锟斤拷锟斤拷 -91 锟饺ｏ拷锟斤拷值锟斤拷锟?270 锟饺讹拷锟斤拷锟斤拷 90 锟饺ｏ拷
         * 锟叫据会当锟斤拷锟斤拷锟斤拷锟斤拷锟斤拷只转一锟斤拷锟斤拷停锟斤拷
         * 锟侥筹拷锟斤拷锟斤拷锟桔硷拷"锟叫凤拷锟斤拷锟斤拷锟斤拷"锟斤拷锟斤拷 锟斤拷180 锟斤拷时锟斤拷 锟斤拷360 锟斤拷锟斤拷锟斤拷 锟斤拷锟斤拷
         * 锟桔加斤拷锟斤拷锟斤拷锟斤拷锟绞碉拷锟斤拷锟阶拷牵锟斤拷锟斤拷锟斤拷锟斤拷薰亍锟?
         * 锟斤拷锟斤拷 10ms 锟斤拷锟斤拷锟斤拷锟?CCD 锟斤拷(40ms)锟斤拷40ms 锟斤拷一锟轿ｏ拷120 锟斤拷/锟斤拷锟斤拷要锟斤拷锟斤拷 4.8 锟饺★拷 */
        {
            float dYaw = Yaw - YawPrev;

            if (dYaw >  180.0f) dYaw -= 360.0f;
            if (dYaw < -180.0f) dYaw += 360.0f;
            YawPrev = Yaw;

            if (CornerState == CORNER_PIVOT)
            {
                PivotTicks += 10;

                /* 前锟斤拷锟轿ｏ拷锟饺帮拷锟斤拷锟斤拷锟酵碉拷转锟斤拷锟较ｏ拷锟劫匡拷始转锟斤拷锟斤拷锟缴硷拷 PIVOT_ADVANCE_MS锟斤拷锟斤拷
                 * 转锟斤拷只锟斤拷"锟斤拷始转"锟斤拷一锟斤拷锟桔加ｏ拷前锟斤拷锟轿碉拷偏锟斤拷锟斤拷锟斤拷锟斤拷锟斤拷锟?90 锟饺★拷 */
                if ((int32_t)PivotTicks >= (int32_t)PIVOT_ADVANCE_MS)
                    YawTurned += dYaw;

                if (((int32_t)PivotTicks >= (int32_t)PIVOT_ADVANCE_MS && fabsf(YawTurned) >= PIVOT_DEG)
                    || (int32_t)PivotTicks >= (int32_t)(PIVOT_ADVANCE_MS + PIVOT_TIMEOUT_MS))
                {
                    CornerState    = CORNER_SETTLE;   /* 转锟角癸拷锟剿ｏ拷锟缴舵，锟斤拷锟斤拷 SETTLE */
                    SettleTicks    = 0;
                    SettleOk       = 0;
                    TurnPID.Target = 0.0f;
                }
            }
            else if (CornerState == CORNER_SETTLE)
            {
                if (SettleTicks < 60000u) SettleTicks += 10;
            }
        }

        /* ================= 锟斤拷锟狡凤拷锟缴ｏ拷锟斤拷态锟斤拷锟斤拷 ================= */
        if (CarState == ST_BALANCE)
        {
            /* ---------- 直锟斤拷锟斤拷原平锟解环锟斤拷----------
             * 取锟斤拷锟脚ｏ拷AnglePID 锟斤拷锟斤拷疃拷锟轿?Target-Actual锟斤拷锟斤拷锟斤拷锟斤拷锟斤拷转锟斤拷锟斤拷
             * 锟斤拷 Angle 锟斤拷锟斤拷锟斤拷锟斤拷锟洁反锟斤拷锟斤拷锟斤拷锟斤拷锟揭拷锟揭伙拷尾哦锟接?锟斤拷锟侥边碉拷锟斤拷锟斤拷锟侥憋拷追"锟斤拷 */
            AnglePID.Actual = Angle;
            PID_Update(&AnglePID);
            AvePWM = -AnglePID.Out;

            LeftPWM  = AvePWM + DifPWM / 2;
            RightPWM = AvePWM - DifPWM / 2;

            if (LeftPWM > 80)        LeftPWM  = 80;
            else if (LeftPWM < -80)  LeftPWM  = -80;
            if (RightPWM > 80)       RightPWM = 80;
            else if (RightPWM < -80) RightPWM = -80;

            TB6612_setPWM(1, LeftPWM);
            TB6612_setPWM(2, RightPWM);
        }
        else if (CarState == ST_ERECT)
        {
            /* ---------- 锟斤拷锟斤拷锟斤拷锟斤拷锟斤拷锟斤拷同锟斤拷同锟斤拷锟斤拷 PWM锟斤拷锟矫凤拷锟斤拷锟斤拷锟斤拷锟截把筹拷甩锟斤拷锟斤拷直 ----------
             * 锟斤拷锟斤拷锟斤拷平锟解环一锟铰ｏ拷Angle>0 锟斤拷前甩锟斤拷Angle<0 锟斤拷锟斤拷甩锟斤拷
             * 前锟斤拷锟斤拷锟斤拷锟斤拷锟斤拷锟矫诧拷同锟斤拷"锟斤拷位锟斤拷"锟斤拷锟斤拷锟斤拷锟斤拷抬锟斤拷锟斤拷锟斤拷锟脚硷拷锟脚匡拷
             * 锟斤拷锟斤拷锟斤拷锟斤拷锟叫诧拷锟斤拷锟斤拷转锟斤拷只锟斤拷转锟津环把诧拷锟斤拷锟斤拷锟斤拷 0锟斤拷 */
            float erectDoneAng = (Angle > 0.0f) ? ERECT_DONE_ANG : ERECT_DONE_ANG_BACK;

            if (fabsf(Angle) <= erectDoneAng)
            {
                /* 锟窖斤拷锟斤拷平锟解范围 -> 锟斤拷锟斤拷平锟解环 */
                PID_ResetAll();
                ErectTime = 0;
                CarState  = ST_BALANCE;
            }
            else if (ErectTime < ERECT_TIMEOUT_MS)
            {
                int16_t swing = (Angle > 0.0f) ? ERECT_PWM : -ERECT_PWM;
                if (ERECT_DIR < 0) swing = -swing;      /* 锟斤拷锟津不对撅拷取锟斤拷 */

                if (ERECT_PULSE_MS > 0 && (ErectTime % ERECT_PERIOD_MS) >= ERECT_PULSE_MS)
                    swing = 0;                          /* 锟斤拷锟斤拷(锟斤拷锟斤拷)模式锟斤拷锟较碉拷锟较讹拷贸锟斤拷锟斤拷锟斤拷约锟斤拷锟剿︼拷锟饺?*/

                /* 转锟斤拷锟节达拷也锟斤拷锟叫ｏ拷锟斤拷目锟斤拷潭锟轿?0锟斤拷只锟斤拷锟斤拷巡锟斤拷锟窖癸拷锟?0 */
                TurnPID.Target = 0.0f;
                TurnPID.Actual = DifSpeed;
                PID_Update(&TurnPID);
                DifPWM = (int16_t)TurnPID.Out;

                LeftPWM  = swing + DifPWM / 2;
                RightPWM = swing - DifPWM / 2;

                if (LeftPWM > 100)        LeftPWM  = 100;
                else if (LeftPWM < -100)  LeftPWM  = -100;
                if (RightPWM > 100)       RightPWM = 100;
                else if (RightPWM < -100) RightPWM = -100;

                TB6612_setPWM(1, LeftPWM);
                TB6612_setPWM(2, RightPWM);
                ErectTime += 10;                        /* 锟斤拷锟斤拷每 10ms 锟斤拷一锟斤拷 */
            }
            else
            {
                /* ---------- 锟斤拷时锟斤拷路锟斤拷太锟斤拷/锟斤拷锟斤拷住/锟斤拷胎锟津滑ｏ拷停锟斤拷 ----------
                 * 锟剿伙拷 IDLE锟斤拷锟劫凤拷一锟斤拷 "1" 锟斤拷锟斤拷锟斤拷锟皆★拷 */
                StopCar();
            }
        }
        else
        {
            /* ---------- ST_IDLE锟斤拷锟较碉拷默锟较ｏ拷锟斤拷锟斤拷锟斤拷系锟?----------
             * 每 10ms 锟斤拷锟斤拷写一锟斤拷 0锟斤拷锟角凤拷锟斤拷式写锟斤拷锟斤拷锟轿猴拷锟斤拷锟斤拷牟锟斤拷锟?PWM 锟斤拷锟结被抹锟斤拷 */
            TB6612_setPWM(1, 0);
            TB6612_setPWM(2, 0);
        }
    }

    Count1 ++;				//锟狡次硷拷锟斤拷

    if (Count1 >= TICK_50MS)		/* ===== 50ms 锟姐：锟劫度伙拷 + 转锟斤拷 ===== */
    {
        Count1 = 0;			//锟狡达拷锟斤拷锟姐，锟斤拷锟斤拷锟铰次硷拷锟斤拷

        /* 锟斤拷锟斤拷锟斤拷锟斤拷每 50ms 锟斤拷一锟斤拷锟斤拷锟斤拷锟斤拷锟斤拷锟斤拷锟皆讹拷锟斤拷锟斤拷锟斤拷锟斤拷锟?
         *   ReadSpeed() 锟斤拷锟斤拷 (short)CNT 锟斤拷锟斤拷锟斤拷锟斤拷锟斤拷锟斤拷锟脚ｏ拷锟斤拷锟斤拷锟缴革拷锟斤拷
         *   44   = 锟斤拷锟阶蝗︼拷募锟斤拷锟斤拷锟斤拷锟?
         *   0.05 = 锟斤拷锟斤拷锟斤拷锟斤拷 50ms
         *   30   = 锟斤拷锟劫憋拷
         *   -> 锟斤拷锟斤拷锟?锟斤拷锟斤拷锟?转/锟斤拷"
         * 锟斤拷锟斤拷取锟斤拷锟脚ｏ拷锟斤拷锟斤拷锟斤拷锟斤拷锟斤拷锟侥硷拷锟斤拷锟斤拷锟斤拷锟洁反锟斤拷锟斤拷锟斤拷统一锟斤拷"前锟斤拷为锟斤拷" */
        LeftSpeed = ReadSpeed(&htim2) / 44.0 / 0.05 / 30;
        RightSpeed = -ReadSpeed(&htim4) / 44.0 / 0.05 / 30;

        /*锟脚号凤拷转*/
			AveSpeed = (LeftSpeed + RightSpeed) / 2.0;	
			DifSpeed = TURN_FB_SIGN * (LeftSpeed - RightSpeed);			
			
			/*执锟斤拷PID锟斤拷锟斤拷锟斤拷*/
			if (CarState == ST_BALANCE)		/* 只锟斤拷直锟斤拷锟斤拷驶时锟斤拷锟斤拷锟劫度伙拷+转锟斤拷 */
			{
				/* ---------- 循锟斤拷前锟斤拷锟劫度ｏ拷锟斤拷锟竭筹拷时锟斤拷锟斤拷 -> 原锟斤拷直锟斤拷 ----------
				 * 摇锟剿凤拷支锟斤拷锟劫革拷锟斤拷循锟斤拷时锟斤拷前锟斤拷锟劫讹拷(锟斤拷 joystick 锟斤拷锟?!TrackMode 锟叫讹拷)锟斤拷锟斤拷锟斤拷锟斤拷锟斤拷锟斤拷
				 * 锟斤拷锟斤拷 SpeedPID.Target 锟斤拷 0锟斤拷锟劫度伙拷锟窖筹拷锟斤拷锟饺碉拷 0锟斤拷AnglePID.Target 锟斤拷锟脚憋拷 0锟斤拷
				 * 锟斤拷只剩 DifPWM 锟斤拷锟斤拷 -> 原锟截达拷转锟斤拷锟斤拷前锟斤拷锟斤拷
				 * 锟斤拷锟竭筹拷锟斤拷 TRACK_LOST_MAX(25 帧 x 40ms = 1s)锟斤拷锟斤拷锟斤拷锟斤拷 CCD 锟斤拷锟斤拷锟?TurnPID.Target
				 * 同时锟斤拷锟斤拷 -> 锟斤拷停住锟斤拷原锟斤拷直锟斤拷锟斤拷锟斤拷锟斤拷盲锟竭筹拷锟斤拷锟斤拷锟斤拷锟?*/
				if (TrackMode)
					SpeedPID.Target = (CornerState != CORNER_LINE) ? TRACK_SPEED : ((TrackLostCnt >= TRACK_LOST_MAX) ? 0.0f : TRACK_SPEED);

				/*锟劫度伙拷PID锟斤拷锟斤拷*/
				SpeedPID.Actual = AveSpeed;			
				PID_Update(&SpeedPID);				//锟斤拷锟矫凤拷装锟矫的猴拷锟斤拷锟斤拷一锟斤拷锟斤拷锟絇ID锟斤拷锟斤拷透锟斤拷锟?
				AnglePID.Target = SpeedPID.Out;		/* 锟解环锟斤拷锟斤拷锟斤拷锟斤拷诨锟侥匡拷辏猴拷锟斤拷锟斤拷司锟斤拷锟角帮拷锟揭伙拷锟斤拷锟斤拷锟斤拷锟?*/
				
				/*转锟斤拷PID锟斤拷锟斤拷*/
				DifSpeedFilter += 0.5f * (DifSpeed - DifSpeedFilter);	/* 转锟斤拷锟劫讹拷一锟阶碉拷通锟斤拷锟斤拷锟狡憋拷锟斤拷锟斤拷锟斤拷锟斤拷/锟斤拷毛锟教ｏ拷系锟斤拷 0.5 锟缴碉拷(0.3 锟斤拷平锟斤拷 / 0.7 锟斤拷锟斤拷锟斤拷) */
				TurnPID.Actual = DifSpeedFilter;			
				PID_Update(&TurnPID);				//锟斤拷锟矫凤拷装锟矫的猴拷锟斤拷锟斤拷一锟斤拷锟斤拷锟絇ID锟斤拷锟斤拷透锟斤拷锟?
				DifPWM = (int16_t)(TurnPID.Out + TURN_FF * TurnPID.Target);	/* 转锟斤拷锟斤拷 + 转锟斤拷前锟斤拷 */
				if (DifPWM > 50) DifPWM = 50; else if (DifPWM < -50) DifPWM = -50;	/* 锟睫凤拷 锟斤拷25/锟街ｏ拷前锟斤拷+锟斤拷锟斤拷锟斤拷锟接猴拷锟斤拷锟阶筹拷锟斤拷锟斤拷锟斤拷锟斤拷锟阶?*/				

        }

    }


    /* 平锟斤拷锟叫碉拷锟铰筹拷锟斤拷 ERECT_START_ANG -> StopCar() 停锟斤拷锟斤拷 IDLE锟斤拷
     * 锟斤拷锟叫讹拷锟斤拷 1ms 锟斤拷执锟叫ｏ拷锟斤拷 Angle 锟斤拷 10ms 锟斤拷锟斤拷一锟轿ｏ拷锟斤拷锟斤拷实锟斤拷锟斤拷应锟斤拷锟斤拷锟斤拷 10ms锟斤拷
     * StopCar() 锟节诧拷锟斤拷锟斤拷 PID_ResetAll()锟斤拷锟斤拷锟斤拷锟劫凤拷一锟斤拷 "1" 时 StartErect()
     * 锟斤拷锟斤拷锟斤拷 Angle_Realign() 锟截讹拷准一锟轿角度★拷 */
    if (CarState == ST_BALANCE && fabsf(Angle) > ERECT_START_ANG)
    {
        StopCar();
    }

    /* ================= CCD 锟斤拷锟斤拷杉锟斤拷锟斤拷锟斤拷牡锟斤拷锟斤拷一锟斤拷锟斤拷=================
     * 位锟斤拷锟角匡拷锟斤拷选锟侥ｏ拷锟斤拷锟侥革拷锟斤拷目锟斤拷锟斤拷锟斤拷锟紸nglePID -> AvePWM -> TB6612_setPWM锟斤拷
     * 锟斤拷 50ms 锟斤拷锟?DifPWM 锟斤拷锟窖撅拷锟斤拷锟疥并写锟斤拷锟侥达拷锟斤拷锟剿ｏ拷锟斤拷 ~0.7ms 锟斤拷锟斤拷锟斤拷
     * 锟斤拷锟斤拷锟狡筹拷锟轿猴拷一锟轿匡拷锟狡讹拷锟斤拷锟斤拷只锟角吃碉拷锟斤拷锟斤拷剩锟斤拷目锟斤拷锟绞憋拷洹?
     *
     * 锟斤拷 锟截癸拷 = CCD_Div x TIM3 锟斤拷锟斤拷(10ms)锟斤拷锟斤拷全锟斤拷锟叫断撅拷锟斤拷锟斤拷锟斤拷锟斤拷循锟斤拷锟睫关★拷
     *   锟斤拷循锟斤拷锟斤拷 OLED_Update() 要锟斤拷 20~24ms锟斤拷锟斤拷锟截癸拷时锟戒不锟斤拷锟斤拷影锟斤拷 锟斤拷锟斤拷
     *   锟斤拷锟斤拷锟斤拷"锟窖采硷拷锟脚斤拷锟叫讹拷"锟斤拷全锟斤拷锟斤拷锟藉。
     *   一帧锟斤拷锟斤拷 锟斤拷0.6ms锟斤拷TIME_us=2 -> CLK 约 110kHz锟斤拷锟斤拷占 10ms 锟斤拷 6%锟斤拷
     *
     * 锟斤拷 CCD_AutoExposure() 锟斤拷锟杰凤拷锟斤拷锟斤。TIM3 锟斤拷锟饺硷拷 0 锟斤拷锟斤拷占 SysTick(锟斤拷锟饺硷拷 15)锟斤拷
     *   锟叫讹拷锟斤拷 HAL_GetTick() 锟角讹拷住锟侥ｏ拷HAL_Delay() 锟斤拷锟斤拷循锟斤拷锟斤拷
     *   锟截癸拷锟斤拷锟斤拷锟斤拷锟斤拷锟窖拷锟斤拷锟斤拷锟斤拷锟街伙拷锟斤拷锟?锟斤拷锟斤拷筒锟?锟斤拷 */
    if (++CCD_count >= CCD_Div)
    {
        CCD_count = 0;
        get_CCD();          /* = RD_TSL()锟斤拷128 锟斤拷锟截讹拷锟斤拷 + 锟斤拷态锟斤拷值 + 锟斤拷锟斤拷 + 锟斤拷锟斤拷 */

        /* ---------- 循锟斤拷锟斤拷锟斤拷锟斤拷偏锟斤拷 -> 转锟斤拷目锟斤拷 ----------
         * 锟斤拷锟斤拷锟斤拷锟斤拷(取锟斤拷一帧之锟斤拷)锟斤拷锟斤拷锟斤拷锟斤拷循锟斤拷锟斤，锟斤拷为锟斤拷"锟斤拷"锟斤拷"锟斤拷"锟斤拷同一锟斤拷锟斤拷桑锟?
         * 转锟斤拷指锟斤拷锟斤拷远锟斤拷锟斤拷锟斤拷锟斤拷锟斤拷锟斤拷莸锟斤拷锟揭恢⊥硷拷锟斤拷锟?
         *
         * 锟斤拷锟竭达拷锟斤拷CCD_Lost 时锟饺诧拷锟斤拷 TurnPID.Target锟斤拷锟斤拷锟斤拷锟斤拷一帧锟斤拷转锟斤拷
         *   锟矫筹拷锟斤拷原锟斤拷锟斤拷盲锟斤拷一小锟轿帮拷锟斤拷锟揭伙拷锟斤拷锟斤拷锟斤拷锟斤拷 TRACK_LOST_MAX 帧锟斤拷锟揭诧拷锟斤拷
         *   锟脚帮拷 Target 锟斤拷锟姐；同时 50ms 锟斤拷锟角帮拷锟斤拷俣锟揭诧拷锟斤拷锟?-> 原锟斤拷直锟斤拷锟斤拷锟斤拷锟斤拷盲锟竭★拷
         *
         * 只锟斤拷 ST_BALANCE 锟斤拷锟斤拷效锟斤拷锟斤拷锟斤拷锟斤拷锟斤拷锟斤拷转锟津环碉拷目锟斤拷潭锟轿?0锟斤拷
         *   锟斤拷锟斤拷锟斤拷循锟斤拷锟斤拷甩锟街阶段诧拷锟街ｏ拷锟斤拷锟斤拷锟斤拷锟斤拷锟斤拷锟揭伙拷锟斤拷锟绞硷拷锟斤拷俣取锟?*/
        if (TrackMode && CarState == ST_BALANCE)
        {
            /* ---------- 锟斤拷帧锟斤拷"锟斤拷状"锟斤拷锟斤拷锟斤拷锟剿碉拷诓锟斤拷锟?+ 锟斤拷锟斤拷锟斤拷锟斤拷锟斤拷 ----------
             * 128 锟轿比斤拷锟斤拷 25Hz 锟斤拷约十锟斤拷锟斤拷 us锟斤拷锟斤拷锟皆猴拷锟皆★拷
             * darkCnt 锟斤拷锟斤拷锟斤拷"直锟斤拷"锟斤拷"锟斤拷锟杰碉拷锟斤拷野锟斤拷缘"锟侥关硷拷锟斤拷
             *   直锟斤拷       锟斤拷锟斤拷锟斤拷锟斤拷一锟斤拷锟揭很匡拷(75)
             *   锟斤拷偏锟斤拷锟斤拷缘 也锟斤拷锟斤拷一锟剿ｏ拷锟斤拷锟斤拷窄(约 10) */
            uint8_t eL      = (ccd_adc[CCD_EDGE_LO] < CCD_Yuzhi) ? 1u : 0u;
            uint8_t eR      = (ccd_adc[CCD_EDGE_HI] < CCD_Yuzhi) ? 1u : 0u;
            uint8_t darkCnt = 0;
            uint8_t kk;

            for (kk = 0; kk < CCD_PIXELS; kk++)
                if (ccd_adc[kk] < CCD_Yuzhi) darkCnt++;

            if (CornerState == CORNER_LINE)
            {
                /* 直锟斤拷确锟较ｏ拷锟斤拷帧没锟叫合凤拷细锟斤拷 + 锟斤拷锟斤拷只锟斤拷住一锟斤拷 + 锟斤拷锟斤拷锟截癸拷锟洁。
                 * 锟斤拷锟斤拷锟斤拷锟斤拷锟斤拷"锟斤拷一锟剿猴拷"锟斤拷锟斤拷头锟斤拷锟斤拷/锟斤拷锟斤拷时锟斤拷锟剿讹拷锟节ｏ拷锟斤拷锟斤拷锟斤拷直锟角★拷 */
                if (CCD_Lost && (eL ^ eR) && darkCnt >= CORNER_MIN_DARK)
                {
                    if (CornerSeen < 255) CornerSeen++;
                }
                else
                {
                    CornerSeen = 0;
                }

                if (CornerSeen >= CORNER_CONFIRM)
                {
                    /* 锟斤拷锟斤拷压锟斤拷锟斤拷一锟剿ｏ拷锟竭撅拷锟斤拷锟侥憋拷锟斤拷 -> 锟斤拷锟角憋拷转锟斤拷
                     * 锟斤拷锟斤拷锟斤拷循锟斤拷锟斤拷锟斤拷通路(Target = TRACK_DIR x 锟斤拷锟斤拷 x 锟斤拷锟斤拷)锟斤拷
                     * 锟斤拷证"转锟斤拷去"锟斤拷"循锟斤拷锟斤拷偏"锟矫碉拷锟斤拷同一锟斤拷锟斤拷锟斤拷约锟斤拷锟斤拷锟斤拷锟矫碉拷锟斤拷锟疥定锟斤拷 */
                    CornerDir      = eR ? 1 : -1;
                    CornerState    = CORNER_PIVOT;
                    YawTurned      = 0.0f;
                    YawPrev        = Yaw;       /* 锟皆憋拷锟斤拷为锟斤拷锟斤拷锟斤拷露锟斤拷锟?*/
                    PivotTicks     = 0;
                    TrackLostCnt   = 0;
                    CornerSeen     = 0;
                    TurnPID.Target = TRACK_DIR * (float)CornerDir * PIVOT_RATE;
                }
                else if (CCD_Lost)
                {
                    if (TrackLostCnt < 255) TrackLostCnt++;
                    if (TrackLostCnt >= TRACK_LOST_MAX)
                        TurnPID.Target = 0.0f;  /* 锟斤拷锟斤拷太锟矫ｏ拷转锟斤拷锟斤拷悖帮拷锟斤拷俣锟斤拷锟?50ms 锟斤拷同时锟斤拷锟斤拷 */
                    /* 锟斤拷锟津保筹拷锟斤拷一帧锟斤拷转锟斤拷锟矫筹拷锟斤拷原锟斤拷锟斤拷盲锟斤拷一小锟轿帮拷锟斤拷锟揭伙拷锟斤拷 */
                }
                else
                {
                    TrackLostCnt = 0;

                    int16_t err = (int16_t)CCD_Zhongzhi - TRACK_CENTER;  /* 锟斤拷锟斤拷锟斤拷 TRACK_CENTER 锟斤拷偏锟斤拷 */
                    if (err > -TRACK_DEAD && err < TRACK_DEAD) err = 0;  /* 锟斤拷锟斤拷锟斤拷锟皆碉拷 锟斤拷1 锟斤拷锟斤拷锟斤拷锟斤拷锟斤拷锟斤拷 */
                    TurnPID.Target = TRACK_DIR * TRACK_GAIN * (float)err / 63.0f;
                }
            }
            else if (CornerState == CORNER_PIVOT)
            {
                /* 转锟斤拷锟斤拷 CCD 锟斤拷锟斤拷锟诫，转锟斤拷目锟斤拷潭锟斤拷锟?
                 * 每帧锟斤拷写一锟轿讹拷锟斤拷锟斤拷只锟节斤拷锟斤拷时写一锟轿ｏ拷50ms 锟斤拷每锟侥讹拷要锟斤拷锟斤拷锟?Target
                 * 锟斤拷 TURN_FF 锟斤拷前锟斤拷锟斤拷锟斤拷锟金处改碉拷锟酵会丢前锟斤拷锟斤拷转锟斤拷锟斤拷锟斤拷 */
                TurnPID.Target = ((int32_t)PivotTicks >= (int32_t)PIVOT_ADVANCE_MS)
                               ? (TRACK_DIR * (float)CornerDir * PIVOT_RATE)
                               : 0.0f;      /* 前锟斤拷锟斤拷锟斤拷直锟叫ｏ拷锟斤拷锟斤拷锟斤拷锟酵碉拷转锟斤拷锟斤拷 */
                TrackLostCnt   = 0;         /* 转锟戒不锟斤拷"锟斤拷锟斤拷"锟斤拷锟斤拷锟矫讹拷锟竭硷拷锟斤拷锟斤拷锟斤拷殉锟酵Ｗ?*/
            }
            else /* CORNER_SETTLE */
            {
                /* 转锟斤拷锟剿ｏ拷锟斤拷直锟斤拷锟剿筹拷直锟角斤拷锟姐，锟斤拷 CCD 锟斤拷锟铰匡拷锟斤拷一锟斤拷锟较凤拷细锟竭★拷
                 * 锟斤拷 锟截硷拷锟斤拷锟斤拷锟斤拷转锟斤拷锟斤拷锟教伙拷 CORNER_LINE锟斤拷锟斤拷转锟斤拷 90 锟斤拷时锟斤拷锟斤拷锟斤拷锟斤拷锟斤拷锟斤拷
                 *   锟竭的斤拷锟斤拷锟较ｏ拷锟斤拷锟斤拷锟斤拷然锟斤拷"锟斤拷锟斤拷锟斤拷锟斤拷一锟斤拷"锟斤拷直锟斤拷锟斤拷锟斤拷锟斤拷锟斤拷锟斤拷锟教憋拷锟斤拷锟斤拷
                 *   锟斤拷一锟斤拷直锟斤拷 -> 锟斤拷锟斤拷原锟斤拷转圈锟斤拷锟斤拷锟斤拷锟斤拷锟斤拷锟阶拷锟斤拷芯锟斤拷锟斤拷锟斤拷锟斤拷蔚锟斤拷锟?*/
                TurnPID.Target = 0.0f;
                TrackLostCnt   = 0;

                if (!CCD_Lost)
                {
                    if (SettleOk < 255) SettleOk++;
                    if (SettleOk >= SETTLE_OK_FRAMES)
                    {
                        CornerState = CORNER_LINE;   /* 锟竭伙拷锟斤拷锟剿ｏ拷锟斤拷锟斤拷锟斤拷锟斤拷循锟斤拷 */
                        CornerSeen  = 0;
                    }
                }
                else
                {
                    SettleOk = 0;
                }

                if (SettleTicks >= SETTLE_TIMEOUT_MS)   /* 锟斤拷时锟斤拷锟斤拷锟戒，锟斤拷循锟斤拷锟斤拷锟斤拷锟皆硷拷锟斤拷 */
                {
                    CornerState = CORNER_LINE;
                    SettleOk    = 0;
                }
            }
        }
    }

    if (__HAL_TIM_GET_FLAG(&htim3, TIM_IT_UPDATE) != RESET)
    {

        if (__HAL_TIM_GET_FLAG(&htim3, TIM_IT_UPDATE) == SET)
        {
            TimerErrorFlag = 1;  // 锟叫断筹拷时锟斤拷牵锟斤拷锟斤拷锟斤拷锟斤拷锟斤拷锟绞憋拷锟揭伙拷锟斤拷卸锟斤拷丫锟斤拷值锟斤拷锟?
                                  // -> 说锟斤拷锟斤拷锟斤拷卸洗锟斤拷锟绞憋拷耍锟斤拷锟斤拷锟斤拷锟斤拷怨鄄锟斤拷锟?

            __HAL_TIM_CLEAR_IT(&htim3, TIM_IT_UPDATE);
        }

        TimerCount = __HAL_TIM_GET_COUNTER(&htim3);
    }
}

/* USER CODE END 0 */

/**
  * @brief  The application entry point.
  * @retval int
  */
int main(void)
{

  /* USER CODE BEGIN 1 */

  /* USER CODE END 1 */

  /* MCU Configuration--------------------------------------------------------*/

  /* Reset of all peripherals, Initializes the Flash interface and the Systick. */
  HAL_Init();

  /* USER CODE BEGIN Init */

  /* USER CODE END Init */

  /* Configure the system clock */
  SystemClock_Config();

  /* USER CODE BEGIN SysInit */

  /* USER CODE END SysInit */

  /* Initialize all configured peripherals */
  MX_GPIO_Init();
  MX_TIM3_Init();
  MX_TIM1_Init();
  MX_TIM2_Init();
  MX_TIM4_Init();
  MX_USART3_UART_Init();
  MX_ADC1_Init();
  /* USER CODE BEGIN 2 */
    HAL_Delay(200);   // 锟斤拷 OLED 锟较碉拷锟饺讹拷锟斤拷锟斤拷锟斤拷锟斤拷锟斤拷锟斤拷锟斤拷锟斤拷示锟届常
    OLED_Init();
    OLED_Clear();

    MPU6050_Init();
    Angle_Realign();   /* 锟较碉拷锟斤拷锟矫硷拷锟劫度计讹拷准锟角讹拷(锟斤拷止时锟斤拷效)锟斤拷锟斤拷锟津互诧拷锟剿诧拷要十锟斤拷锟斤拷锟斤拷锟斤拷锟斤拷锟?
                        * 锟节间发锟斤拷"1"锟斤拷锟矫筹拷锟斤拷锟脚达拷锟斤拷慕嵌锟饺ニ︼拷帧锟斤拷舜锟?TIM3 锟叫断伙拷没锟斤拷锟斤拷锟斤拷全锟斤拷 */
    HAL_TIM_PWM_Start(&htim1, TIM_CHANNEL_1);
    HAL_TIM_PWM_Start(&htim1, TIM_CHANNEL_4);
    HAL_TIM_Encoder_Start(&htim2, TIM_CHANNEL_ALL);
    HAL_TIM_Encoder_Start(&htim4, TIM_CHANNEL_ALL);
    Ccd_Init();          /* CCD 锟斤拷锟叫碉拷平锟斤拷CLK=H, SI=L锟斤拷锟较革拷说 RD_TSL() 每帧锟斤拷头锟斤拷锟斤拷
                          * 锟斤拷锟斤拷锟借定锟斤拷锟斤拷锟斤拷锟斤拷平锟斤拷锟斤拷锟斤拷锟斤拷一锟斤拷锟斤拷锟斤拷锟斤拷模锟斤拷锟斤拷锟斤拷锟街伙拷锟轿拷锟?
                          * 锟斤拷 CCD 原锟斤拷锟教的筹拷始锟斤拷锟斤拷锟斤拷一锟铰ｏ拷锟斤拷锟斤拷锟皆猴拷锟绞憋拷锟揭伙拷锟斤拷锟饺凤拷锟姐。 */
    BlueSerial_Init();   // 锟斤拷始锟斤拷锟斤拷锟斤拷锟斤拷锟节斤拷锟斤拷
    HAL_TIM_Base_Start(&htim3);
    uint8_t ID;
    ID = MPU6050_GetID();   /* 锟斤拷 WHO_AM_I锟斤拷0x68 说锟斤拷 MPU6050 锟斤拷锟竭★拷锟斤拷锟斤拷锟角拔词癸拷茫锟?
                             * 锟斤拷要时锟缴放碉拷 OLED 锟较匡拷锟斤拷确锟较达拷锟斤拷锟斤拷锟角凤拷应锟斤拷 */
    OLED_Update();
    MX_TIM3_Init();                  /* 锟截革拷锟斤拷始锟斤拷一锟斤拷 TIM3锟斤拷锟斤拷锟斤拷锟斤拷 MX_TIM3_Init() 同锟斤拷锟斤拷锟矫ｏ拷锟斤拷
                                      * 确锟斤拷锟节匡拷锟叫讹拷前锟侥达拷锟斤拷锟角干撅拷锟斤拷 */
    HAL_TIM_Base_Start_IT(&htim3);   /* 10ms update interrupt锟斤拷tim.c: Period = 10000-1锟斤拷*/
    PID_Init(&AnglePID);
    PID_Init(&SpeedPID);
    PID_Init(&TurnPID);

    CarState = ST_IDLE;          /* 锟较碉拷默锟较ｏ拷锟斤拷锟斤拷系纾拷锟斤拷锟斤拷锟?"1" 锟脚匡拷始 */

    // 预锟矫角度伙拷锟斤拷睿拷锟斤拷锟轿拷殖锟斤拷
    AnglePID.Actual = Angle;
    AnglePID.Actual1 = Angle;   //同锟斤拷预锟斤拷锟较达拷实锟斤拷值锟斤拷锟斤拷止微锟斤拷锟斤拷锟揭伙拷某锟斤拷
    AnglePID.Error0 = AnglePID.Target - AnglePID.Actual;
    AnglePID.Error1 = AnglePID.Error0;    
  /* USER CODE END 2 */

  /* Infinite loop */
  /* USER CODE BEGIN WHILE */
    while (1)
    {
        int len;
        uint8_t i;
        static uint32_t lastSendTime = 0;
//	TB6612_setPWM(2,100);

        /* 状态指示锟狡ｏ拷PC13锟斤拷锟酵碉拷平锟斤拷锟斤拷锟斤拷锟斤拷
         *   熄锟斤拷 = IDLE 锟斤拷锟斤拷    锟斤拷烁 = ERECT 锟斤拷锟斤拷锟斤拷锟斤拷    锟斤拷锟斤拷 = BALANCE 直锟斤拷锟斤拷驶
         *   锟斤拷烁锟斤拷 ErectTime/150 锟斤拷锟斤拷锟斤拷每 150ms 锟斤拷转一锟斤拷 */
        {
            uint8_t ledOff;
            if (CarState == ST_BALANCE)     ledOff = 0;
            else if (CarState == ST_ERECT)  ledOff = (uint8_t)((ErectTime / 150u) & 1u);
            else                            ledOff = 1;
            HAL_GPIO_WritePin(GPIOC, GPIO_PIN_13, ledOff ? GPIO_PIN_SET : GPIO_PIN_RESET);
        }


        /* ---------- OLED 锟斤拷锟街ｏ拷128x64锟斤拷OLED_6X8 锟斤拷锟斤拷每锟街凤拷 6 锟斤拷锟截匡拷----------
         *   y=0        CCD: D<锟截癸拷Div> <ms>ms  M<Max> m<Min>
         *   y=8        CCD: T<锟斤拷值> Z<锟斤拷锟斤拷> <锟斤拷锟斤拷>-<锟斤拷锟斤拷> L<锟斤拷锟斤拷>
         *   y=16..31   CCD: 128 锟斤拷锟截诧拷锟斤拷 + 锟斤拷值锟斤拷锟斤拷
         *   y=32   T:<锟角度伙拷目锟斤拷值>        (x=0,  锟斤拷 0..41)
         *          Yaw:<偏锟斤拷锟斤拷 锟斤拷>         (x=60, 锟斤拷 60..125)
         *   y=40   Angle:<锟角度伙拷实锟斤拷值>    (x=0)
         *   y=48   O:<锟角度伙拷锟斤拷锟?          S:<锟斤拷锟斤拷转锟斤拷>      (x=70)
         *   y=56   S<锟斤拷锟斤拷转锟斤拷>             (x=84)
         *
         * 每锟斤拷锟斤拷锟?21 锟斤拷锟街凤拷锟斤拷128/6锟斤拷锟斤拷锟筋长锟斤拷锟斤拷 "T255 Z127 127-127 L1" = 20 锟街凤拷锟斤拷
         * 锟斤拷锟斤拷越锟界。锟街段硷拷喽硷拷前锟?6 锟斤拷锟斤拷/锟街凤拷锟斤拷玫模锟斤拷锟斤拷锟斤拷氐锟斤拷锟?
         * 锟斤拷 OLED.c 写锟皆达拷锟矫碉拷锟斤拷 |= 锟斤拷锟斤拷锟斤拷 =锟斤拷锟街讹拷一锟斤拷锟截碉拷锟结按"锟斤拷位锟斤拷"锟斤拷锟斤拷锟斤拷锟斤拷锟斤拷
         *   锟斤拷锟斤拷锟角伙拷锟洁覆锟斤拷 锟斤拷锟斤拷 锟斤拷锟皆改诧拷锟斤拷时锟斤拷锟斤拷锟皆硷拷锟斤拷锟饺★拷
         * 锟斤拷 锟诫看 PID 锟斤拷锟斤拷锟叫憋拷注锟酵碉拷锟斤拷 KP/KI/KD锟斤拷锟斤拷锟饺帮拷 CCD 锟斤拷 y=0/y=8 挪锟竭ｏ拷
         *   锟斤拷锟斤拷 y=8 锟斤拷锟?KP 锟叫帮拷位锟斤拷锟斤拷锟揭伙拷锟?*/
        OLED_Clear();
/* ===================== CCD 锟斤拷锟斤拷锟斤拷示 =====================
 * 锟斤拷锟斤拷锟斤拷锟斤拷取 0..CCD_Max锟斤拷锟斤拷锟斤拷取 0 锟斤拷锟斤拷锟斤拷 CCD_Min锟斤拷
 * 锟斤拷锟斤拷 Min..Max 锟皆讹拷锟斤拷锟届，锟斤拷 CCD_Yuzhi 锟街猴拷锟斤拷锟?(Max+Min)/2锟斤拷
 * 锟斤拷值锟竭撅拷锟斤拷远锟斤拷锟斤拷锟斤拷锟叫间，锟斤拷锟斤拷没锟斤拷锟斤拷取 0 锟斤拷锟斤拷锟睫猴拷
 * "锟斤拷值锟斤拷锟节诧拷锟轿讹拷叩锟轿伙拷锟?锟斤拷锟斤拷锟斤拷锟斤拷息锟斤拷锟侥★拷
 *
 * 锟斤拷 ccd_adc[] 锟斤拷 TIM3 锟叫讹拷写锟斤拷锟斤拷锟斤拷锟斤拷锟斤拷锟斤拷锟斤拷锟斤拷锟剿猴拷锟街★拷锟斤拷锟斤拷锟斤拷锟斤拷掳锟缴ｏ拷锟斤拷
 *   锟斤拷锟斤拷 锟斤拷 0.6ms/(CCD_Div x 10ms) 锟斤拷 1.5%锟斤拷只影锟斤拷锟斤拷一锟斤拷锟斤拷锟芥，锟斤拷一帧锟斤拷锟街革拷锟斤拷
 *   锟斤拷锟皆诧拷锟斤拷双锟斤拷锟藉。
 * 锟斤拷 128 锟斤拷 OLED_DrawPoint 约 130us锟斤拷锟斤拷锟?OLED_Update() 锟斤拷 ~23ms 锟缴猴拷锟皆★拷 */
        {
            uint8_t  k;
            uint16_t den = CCD_Max ? CCD_Max : 1u;   /* 锟斤拷锟斤拷锟斤拷锟斤拷锟斤拷 = 锟斤拷帧锟斤拷锟斤拷锟斤拷锟斤拷锟斤拷 0 */
            uint8_t  ty;

            OLED_Printf(0, 0, OLED_6X8, "D%u %ums M%u m%u",
                        (unsigned)CCD_Div, (unsigned)(CCD_Div * 10u),
                        (unsigned)CCD_Max, (unsigned)CCD_Min);

            OLED_Printf(0, 8, OLED_6X8, "T%u Z%u %u-%u L%u",
                        (unsigned)CCD_Yuzhi, (unsigned)CCD_Zhongzhi,
                        (unsigned)CCD_Left,  (unsigned)CCD_Right, (unsigned)CCD_Lost);

            /* 直锟斤拷转锟斤拷状态锟斤拷C0=循锟斤拷锟斤拷 C1=锟斤拷锟斤拷转 C2=锟斤拷锟竭伙拷锟斤拷锟斤拷锟斤拷锟斤拷锟斤拷锟斤拷锟斤拷奂锟阶拷锟?*/
            OLED_Printf(92, 8, OLED_6X8, "C%u%+03.0f",
                        (unsigned)CornerState, (double)YawTurned);

            /* 锟斤拷锟轿ｏ拷一锟斤拷一锟姐，128 锟斤拷锟斤拷锟斤拷锟斤拷锟斤拷锟斤拷锟斤拷 */
            for (k = 0; k < CCD_PIXELS; k++)
            {
                uint8_t h = (uint8_t)((uint32_t)ccd_adc[k] * 15u / den);
                if (h > 15) h = 15;
                OLED_DrawPoint(k, (int16_t)(31 - h));
            }

            /* 锟斤拷值锟竭ｏ拷锟斤拷锟竭ｏ拷每 4 锟斤拷锟斤拷一锟姐）锟斤拷锟斤拷锟斤拷锟斤拷值锟斤拷应锟侥高讹拷锟斤拷 */
            ty = (uint8_t)(31 - ((uint32_t)CCD_Yuzhi * 15u / den));
            if (ty > 31) ty = 31;
            for (k = 0; k < CCD_PIXELS; k += 4) OLED_DrawPoint(k, (int16_t)ty);
        }

//        OLED_Printf(0, 0, OLED_6X8, "ST:%s %d", StateStr(), (int)ErectTime);   /* 状态 + 锟斤拷锟斤拷锟斤拷时(ms) */
//        OLED_Printf(0, 8, OLED_6X8, "KP:%05.2f//%05.2f//%05.2f ", AnglePID.Kp, SpeedPID.Kp, TurnPID.Kp);		//锟角度伙拷Kp
//        OLED_Printf(0, 16, OLED_6X8, "KI:%05.2f//%05.2f//%05.2f", AnglePID.Ki, SpeedPID.Ki, TurnPID.Ki);		//锟角度伙拷Ki
//        OLED_Printf(0, 24, OLED_6X8, "KD:%05.2f//%05.2f//%05.2f", AnglePID.Kd, SpeedPID.Kd, TurnPID.Kd);		//锟角度伙拷Kd
        OLED_Printf(0, 32, OLED_6X8, "T:%+05.1f", AnglePID.Target);	//锟角度伙拷目锟斤拷值
        OLED_Printf(60, 32, OLED_6X8, "Yaw:%+07.2f", Yaw);			//偏锟斤拷锟斤拷(锟斤拷)锟斤拷锟斤拷头锟斤拷转为锟斤拷
        OLED_Printf(0, 40, OLED_6X8, "Angle:%+05.1f", Angle);			//锟角度伙拷实锟斤拷值
        OLED_Printf(0, 48, OLED_6X8, "O:%+05.0f", AnglePID.Out);	//锟角度伙拷锟斤拷锟街?
//        OLED_Printf(0, 56, OLED_6X8, "GX%+05.1f", GX / GYRO_LSB_PER_DPS);  /* X锟斤拷锟斤拷俣锟?锟斤拷/s)锟斤拷锟斤拷止应为 0 */
//        OLED_Printf(42, 56, OLED_6X8, "GZ%+05.1f", GZ / GYRO_LSB_PER_DPS);  /* Z锟斤拷锟斤拷俣锟?锟斤拷/s)锟斤拷锟斤拷止锟斤拷锟斤拷应锟接斤拷 YAW_BIAS_DPS */
//        OLED_Printf(70, 40, OLED_6X8, "G:%+02.2f", G);
        OLED_Printf(70, 48, OLED_6X8, "S:%+02.2f", RightSpeed);
        OLED_Printf(84, 56, OLED_6X8, "S%+02.2f", LeftSpeed);
        OLED_Printf(0, 56, OLED_6X8, "TRK%c%+05.2f", TrackMode ? '!' : '-', TurnPID.Target);/* ! = 循锟斤拷锟叫ｏ拷- = 锟斤拷循锟斤拷 */
        OLED_Update();


        /* ---- 锟斤拷锟斤拷锟斤拷锟筋：锟斤拷锟街革拷式锟斤拷支锟斤拷 ----
         *   锟斤拷锟街凤拷锟斤拷锟街伙拷锟斤拷锟斤拷锟斤拷锟斤拷直锟斤拷锟矫ｏ拷锟斤拷'1' = 锟斤拷锟斤拷   '0' = 锟斤拷停   'T'/'t' = 锟叫伙拷循锟斤拷
         *   [锟斤拷]锟斤拷App/锟斤拷位锟斤拷锟斤拷锟斤拷[1] / [0] / [t] 锟斤拷锟斤拷锟斤拷同锟斤拷锟斤拷锟解还锟叫伙拷锟斤拷锟揭★拷锟?
         *
         * 锟斤拷 'T'/'t' 锟斤拷锟诫发锟斤拷锟街节★拷BlueSerial.c 锟侥斤拷锟斤拷状态锟斤拷只锟斤拷"锟斤拷锟斤拷 [ ] 锟斤拷锟斤拷"
         *   时锟脚帮拷锟街斤拷锟酵斤拷锟斤拷锟斤拷锟斤拷锟酵拷锟斤拷锟斤拷锟斤拷锟?"[T]" 锟结被锟斤拷锟缴帮拷锟斤拷锟捷斤拷锟斤拷锟斤拷锟?Tag 锟斤拷支锟斤拷
         *   锟斤拷 Tag 只锟斤拷 1/0/t/key/slider/joystick 锟斤拷锟斤拷 "[T]" 锟斤拷效锟斤拷"[t]" 锟斤拷效锟斤拷 */
        /* ---- PA5 用户按键：三段循环  启动 -> 循迹 -> 关闭 -> 回到启动 ----
         * 中断只置标志，这里消费（原因见 HAL_GPIO_EXTI_Callback 上方注释）。
         *
         * 不额外记一个 KeyStage 变量，而是直接从 CarState + TrackMode 推：
         *   ① IDLE                     -> StartErect()   甩轮起立
         *   ② BALANCE 且 TrackMode==0  -> TrackMode=1    进循迹
         *   ③ BALANCE 且 TrackMode==1  -> StopCar()      关循迹+停车 -> 回 IDLE
         *   ④ ERECT                    -> StopCar()      放弃起立 -> 回 IDLE
         * 这样"按键走到第几段"和"车真实处于哪一步"永远是同一份数据，
         * 不会出现两边打架、按了第四次却还停在第二段的情形。
         *
         * OLED 对照（第 0 行 ST: + 第 7 行 TRK）：
         *   ST:IDLE        -> 等第①击
         *   ST:BAL + TRK-  -> 等第②击
         *   ST:BAL + TRK!  -> 等第③击
         *
         * ST_ERECT（起立中）的按键 = 放弃起立（第④击），不再无视：
         *   生效门槛 ErectTime >= ERECT_ABORT_GUARD_MS(300)。
         *   StartErect() 内部 Angle_Realign() 有 300ms 阻塞，这段里车完全不动，
         *   很容易被当成"没响应"再按一次；那次 KeyFlag 会在 StartErect 返回后
         *   立刻被消费，而此刻 ErectTime 还是 0 —— 没有门槛的话，刚甩起来的车
         *   会被这一下直接按停。 */
        if (KeyFlag)
        {
            KeyFlag = 0;

            if (CarState == ST_IDLE)
            {
                /* ① 起立。顺手关掉循迹：上一轮若是摔车/超时从 ST_BALANCE
                 * 掉回来的，StopCar() 已经清过 TrackMode；这里再写一次是让
                 * "起立时不带循迹"这条约束在代码上看得见（双保险）。 */
                TrackMode    = 0;
                TrackLostCnt = 0;
                StartErect();
            }
            else if (CarState == ST_BALANCE)
            {
                if (!TrackMode)
                {
                    /* ② 进循迹。丢线计数、转向目标、直角状态一起清零，
                     * 否则会带着上一轮的指令和 PIVOT 状态瞬间抢一下。 */
                    TrackMode      = 1;
                    TrackLostCnt   = 0;
                    TurnPID.Target = 0.0f;
                    CornerState    = CORNER_LINE;
                    CornerSeen     = 0;
                }
                else
                {
                    /* ③ 关循迹 + 停车。TrackLostCnt 与 TurnPID.Target 由
                     * StopCar() -> PID_ResetAll() 一并清掉，这里只说意图。 */
                    TrackMode = 0;
                    StopCar();
                }
            }
            else
            {
                /* ④ 放弃起立。门槛见上方注释：ErectTime 是进入 ERECT 后的毫秒
                 * 计数（StartErect 里清零、10ms 节拍里累加），用来挡掉 ① 之后
                 * 那段 300ms 阻塞期里"以为没响应"的第二次按键。
                 *
                 * StopCar() 会一并清掉 TrackMode / TrackLostCnt / ErectTime，
                 * 所以放弃起立后必定回到干净的 IDLE，下次按键还是从第①击开始。 */
                if (ErectTime >= ERECT_ABORT_GUARD_MS)
                {
                    StopCar();
                }
            }
        }
        if (BlueSerial_CmdFlag)
        {
            char cmd = BlueSerial_CmdChar;
            BlueSerial_CmdFlag = 0;
            if      (cmd == '1') { StartErect(); }
            else if (cmd == '0') { StopCar(); }
            else if (cmd == 'T' || cmd == 't')
            {
                /* 锟叫伙拷循锟斤拷锟斤拷锟截★拷顺锟斤拷锟斤拷锟斤拷锟斤拷呒锟斤拷锟斤拷筒锟斤拷锟斤拷锟阶拷锟侥匡拷辏?
                 * 锟斤拷锟斤拷锟斤拷一锟斤拷循锟斤拷锟斤拷锟铰碉拷 Target 锟斤拷锟叫伙拷瞬锟斤拷锟斤拷沙锟斤拷 */
                TrackMode      = !TrackMode;
                TrackLostCnt   = 0;
                TurnPID.Target = 0.0f;
                CornerState    = CORNER_LINE;   /* 顺锟斤拷锟剿筹拷直锟斤拷转锟斤拷状态 */
                CornerSeen     = 0;
            }
        }

        /* 锟斤拷锟斤拷锟斤拷锟斤拷锟斤拷锟秸伙拷锟斤拷郏锟斤拷锟斤拷锟斤拷锟斤拷锟斤拷锟斤拷锟斤拷锟?[锟斤拷] */
        for (i = 0; i < 2; i++)
        {
            if (BlueSerial_RxFlag[i] == 1)
            {
                char *Tag = strtok(BlueSerial_RxPacket[i], ",");	//取锟斤拷1锟轿ｏ拷锟斤拷为锟斤拷签Tag

                if (Tag != NULL)
                {
                    if (strcmp(Tag, "1") == 0)                  /* 锟秸碉拷 [1] -> 锟斤拷锟斤拷 */
                    {
                        StartErect();
                    }
                    else if (strcmp(Tag, "0") == 0)             /* 锟秸碉拷 [0] -> 锟斤拷停 */
                    {
                        StopCar();
                    }
                    else if (strcmp(Tag, "t") == 0)             /* 锟秸碉拷 [t] -> 锟叫伙拷循锟斤拷锟斤拷小写锟斤拷锟斤拷效锟斤拷锟斤拷写 T 要锟斤拷锟斤拷锟街节ｏ拷 */
                    {
                        TrackMode      = !TrackMode;
                        TrackLostCnt   = 0;
                        TurnPID.Target = 0.0f;
                        CornerState    = CORNER_LINE;   /* 顺锟斤拷锟剿筹拷直锟斤拷转锟斤拷状态 */
                        CornerSeen     = 0;
                    }
                    else if (strcmp(Tag, "key") == 0)           /* [key,锟斤拷锟斤拷,锟斤拷锟斤拷]锟斤拷锟斤拷锟斤拷帧 */
                    {
                        char *Name = strtok(NULL, ",");			//取锟斤拷2锟轿ｏ拷锟斤拷为锟斤拷锟斤拷锟斤拷锟斤拷
                        char *Action = strtok(NULL, ",");		//取锟斤拷3锟轿ｏ拷锟斤拷为锟斤拷锟斤拷锟斤拷锟斤拷

                        /*锟剿达拷执锟叫帮拷锟斤拷锟斤拷锟斤拷锟斤拷目前锟斤拷锟斤拷锟斤拷时没锟斤拷锟矫碉拷*/
                    }
                    else if (strcmp(Tag, "slider") == 0)	//[slider,锟斤拷锟斤拷,值]锟斤拷锟斤拷锟斤拷帧锟斤拷锟斤拷锟斤拷锟斤拷锟竭碉拷锟斤拷
                    {
                        char *Name = strtok(NULL, ",");			//取锟斤拷2锟轿ｏ拷锟斤拷为锟斤拷锟斤拷锟斤拷锟斤拷
                        char *Value = strtok(NULL, ",");		//取锟斤拷3锟轿ｏ拷锟斤拷为锟斤拷锟斤拷值

                        /*执锟叫伙拷锟斤拷锟斤拷锟斤拷锟斤拷锟斤拷锟轿伙拷锟斤拷锟斤拷锟斤拷锟街敌达拷锟斤拷锟接︼拷锟?PID 锟斤拷锟斤拷*/
                        if (strcmp(Name, "AngleKp") == 0)	//锟斤拷锟斤拷锟斤拷锟斤拷为AngleKp
                        {
                            AnglePID.Kp = atof(Value);		//锟窖伙拷锟斤拷值锟斤拷锟斤拷锟角度伙拷Kp
                        }
                        else if (strcmp(Name, "AngleKi") == 0)	//锟斤拷锟斤拷锟斤拷锟斤拷为AngleKi
                        {
                            AnglePID.Ki = atof(Value);		//锟窖伙拷锟斤拷值锟斤拷锟斤拷锟角度伙拷Ki
                        }
                        else if (strcmp(Name, "AngleKd") == 0)	//锟斤拷锟斤拷锟斤拷锟斤拷为AngleKd
                        {
                            AnglePID.Kd = atof(Value);		//锟窖伙拷锟斤拷值锟斤拷锟斤拷锟角度伙拷Kd
                        }
                        else if (strcmp(Name, "G") == 0)	//锟斤拷锟斤拷锟斤拷锟斤拷为G锟斤拷锟角讹拷锟斤拷锟狡拷锟?
                        {
                            G = atof(Value);		//锟窖伙拷锟斤拷值锟斤拷锟斤拷锟角讹拷锟斤拷锟狡拷锟?
                        }
                        else if (strcmp(Name, "SpeedKp") == 0)		//锟斤拷锟斤拷锟斤拷锟斤拷为SpeedKp
                        {
                            SpeedPID.Kp = atof(Value);				//锟窖伙拷锟斤拷值锟斤拷锟斤拷锟劫度伙拷Kp
                        }
                        else if (strcmp(Name, "SpeedKi") == 0)		//锟斤拷锟斤拷锟斤拷锟斤拷为SpeedKi
                        {
                            SpeedPID.Ki = atof(Value);				//锟窖伙拷锟斤拷值锟斤拷锟斤拷锟劫度伙拷Ki
                        }
                        else if (strcmp(Name, "SpeedKd") == 0)		//锟斤拷锟斤拷锟斤拷锟斤拷为SpeedKd
                        {
                            SpeedPID.Kd = atof(Value);				//锟窖伙拷锟斤拷值锟斤拷锟斤拷锟劫度伙拷Kd
                        }
                        else if (strcmp(Name, "TurnKp") == 0)		//锟斤拷锟斤拷锟斤拷锟斤拷为TurnKp
                        {
                            TurnPID.Kp = atof(Value);				//锟窖伙拷锟斤拷值锟斤拷锟斤拷转锟斤拷Kp
                        }
                        else if (strcmp(Name, "TurnKi") == 0)		//锟斤拷锟斤拷锟斤拷锟斤拷为TurnKi
                        {
                            TurnPID.Ki = atof(Value);				//锟窖伙拷锟斤拷值锟斤拷锟斤拷转锟斤拷Ki
                        }
                        else if (strcmp(Name, "TurnKd") == 0)		//锟斤拷锟斤拷锟斤拷锟斤拷为TurnKd
                        {
                            TurnPID.Kd = atof(Value);				//锟窖伙拷锟斤拷值锟斤拷锟斤拷转锟斤拷Kd
                        }

                    }
                    else if (strcmp(Tag, "joystick") == 0)		//[joystick,LH,LV,RH,RV]锟斤拷摇锟斤拷帧
                    {
                        int8_t LH = atoi(strtok(NULL, ","));		//取锟斤拷2锟轿ｏ拷锟斤拷为摇锟斤拷值LH
                        int8_t LV = atoi(strtok(NULL, ","));		//取锟斤拷3锟轿ｏ拷锟斤拷为摇锟斤拷值LV
                        int8_t RH = atoi(strtok(NULL, ","));		//取锟斤拷4锟轿ｏ拷锟斤拷为摇锟斤拷值RH
                        int8_t RV = atoi(strtok(NULL, ","));		//取锟斤拷5锟轿ｏ拷锟斤拷为摇锟斤拷值RV

                        /*执锟斤拷摇锟剿诧拷锟斤拷*/
                        /* 摇锟剿伙拷锟斤拷锟斤拷锟斤拷锟斤拷锟斤拷锟斤拷 锟斤拷5 锟斤拷锟节碉拷锟斤拷漂 */
                        if (LV > -5 && LV < 5) { LV = 0; }
                        if (!TrackMode) SpeedPID.Target = LV / 50.0;   /* 循锟斤拷时前锟斤拷锟劫讹拷锟斤拷 TRACK_SPEED 锟斤拷 50ms 锟斤拷锟?*/

                        /* 循锟斤拷模式锟斤拷摇锟剿碉拷锟斤拷锟揭凤拷锟斤拷锟劫诧拷锟街ｏ拷
                         *   循锟斤拷锟斤拷锟斤拷 TurnPID.Target 锟斤拷锟狡凤拷锟斤拷摇锟斤拷一锟斤拷司桶锟斤拷锟斤拷慕锟斤拷锟角碉拷锟斤拷
                         *   锟斤拷锟斤拷锟斤拷锟斤拷锟斤拷锟斤拷员锟斤拷同一锟斤拷锟斤拷锟斤拷锟斤拷锟斤拷只锟节凤拷循锟斤拷时锟脚斤拷锟斤拷 RH锟斤拷 */
                        if (!TrackMode)
                        {
                            if (RH > -5 && RH < 5) { RH = 0; }
                            TurnPID.Target = -RH / 50.0;   //RH>0=锟斤拷转锟斤拷锟斤拷 Target 取锟斤拷
                            if (TurnPID.Target != 0.0f && LV == 0)
                                SpeedPID.Target = 0.20f;  /* 只转锟津不革拷锟劫讹拷时锟斤拷锟斤拷一锟斤拷前锟斤拷锟劫度ｏ拷锟斤拷锟斤拷原锟截达拷转 */
                        }

                    }
                }

                BlueSerial_RxFlag[i] = 0;				//锟斤拷锟斤拷锟斤拷珊锟斤拷志位锟斤拷0锟斤拷锟皆憋拷锟斤拷锟斤拷锟揭恢★拷锟斤拷锟?
            }
        }

        /* ---------- 锟斤拷位锟斤拷锟斤拷锟斤拷锟斤拷锟斤拷锟斤拷锟角帮拷锟斤拷锟斤拷锟斤拷乇眨锟?---------
         * 锟斤拷锟斤拷路锟斤拷锟斤拷 huart3(锟斤拷锟斤拷)锟斤拷锟截荷诧拷一锟斤拷锟斤拷锟斤拷锟斤拷锟斤拷
         *   [plot,GZ,Yaw]    每锟斤拷约 19 锟街节ｏ拷只锟斤拷锟斤拷态锟斤拷锟结，锟绞合筹拷时锟戒盯锟脚匡拷
         *   CCD_SendFrame()  每帧 270 锟街节ｏ拷'*LD' + 264 hex + '00' + '#'锟斤拷锟斤拷
         *                    锟斤拷 128 锟斤拷原始锟斤拷锟轿ｏ拷锟截ｏ拷只锟节匡拷 CCD 时锟斤拷
         *
         * 锟斤拷 为什么锟斤拷锟斤拷锟斤拷注锟酵碉拷锟剿ｏ拷CCD 锟缴硷拷锟斤拷锟斤拷锟斤拷锟斤拷锟狡伙拷全锟斤拷 TIM3 锟叫讹拷锟斤，
         *   锟斤拷锟斤拷锟斤拷硬锟斤拷锟斤拷时锟斤拷锟斤拷证锟斤拷锟斤拷锟斤拷"锟斤拷锟斤拷锟斤拷"锟斤拷锟斤拷影锟届车锟侥匡拷锟狡ｏ拷只影锟斤拷
         *   OLED 刷锟铰猴拷锟斤拷锟斤拷指锟斤拷锟斤拷锟接︼拷俣取锟斤拷锟斤拷锟斤拷锟揭伙拷锟斤拷潭染筒锟斤拷锟斤拷锟斤拷耍锟?
         *     USART3 锟斤拷锟斤拷锟斤拷 9600 锟斤拷锟截ｏ拷270 锟街斤拷要 281ms锟斤拷锟斤拷循锟斤拷锟斤拷 ~45ms
         *     直锟斤拷锟角碉拷 ~326ms 锟斤拷锟斤拷 锟斤拷 CCD 40ms 锟酵筹拷一帧锟斤拷锟斤拷锟斤拷 8 帧锟斤拷锟斤拷 7 帧锟斤拷
         *     OLED 也锟斤拷锟斤拷锟桔可硷拷锟截匡拷锟斤拷
         *   19 锟街节碉拷 [plot] 只要 ~20ms锟斤拷锟斤拷锟斤拷 OLED_Update() 锟斤拷 ~23ms 锟斤拷锟接猴拷
         *   锟斤拷循锟斤拷锟窖撅拷锟斤拷 ~44.6ms锟斤拷锟劫碉拷锟斤拷锟斤拷锟酵革拷锟斤拷锟剿★拷
         *   锟诫看锟杰诧拷锟轿ｏ拷唯一实锟矫的办法锟角帮拷 USART3 锟结到 115200
         *   锟斤拷270 锟街斤拷 = 23.4ms锟斤拷锟斤拷同时锟斤拷锟斤拷锟斤拷模锟斤拷也锟侥筹拷 115200锟斤拷锟斤拷锟斤拷锟斤拷路直锟接断★拷
         *
         * 锟斤拷 CCD_SendFrame() 只锟截讹拷锟斤拷锟揭伙拷尾杉锟斤拷慕锟斤拷(ccd.c:301-319)锟斤拷锟斤拷锟斤拷锟斤拷
         *   锟铰的诧拷锟斤拷锟斤拷锟斤拷锟皆打开猴拷锟斤拷位锟斤拷锟斤拷锟斤拷锟侥诧拷锟轿★拷锟斤拷值锟竭★拷锟斤拷锟竭憋拷志锟斤拷 OLED 锟斤拷
         *   同一帧锟斤拷锟斤拷锟竭对碉拷锟较★拷
         *
         * 要锟斤拷锟斤拷一锟斤拷锟斤拷去锟斤拷锟斤拷应锟角硷拷锟叫碉拷注锟酵ｏ拷锟斤拷锟斤拷锟斤拷要同时锟斤拷锟斤拷锟截荷会翻锟斤拷锟斤拷 */
//        len = sprintf(display_buf, "[plot,%d,%.2f]",GZ,Yaw);//TurnPID.Target,DifSpeed,DifPWM,%d
//        HAL_UART_Transmit(&huart3, (uint8_t *)display_buf, (uint16_t)len, 100);

//      CCD_SendFrame();        /* 270 锟街斤拷: '*LD' + 264 hex + '00' + '#' */
    }

    /* USER CODE END WHILE */

    /* USER CODE BEGIN 3 */

  /* USER CODE END 3 */
}

/**
  * @brief System Clock Configuration
  * @retval None
  */
void SystemClock_Config(void)
{
  RCC_OscInitTypeDef RCC_OscInitStruct = {0};
  RCC_ClkInitTypeDef RCC_ClkInitStruct = {0};
  RCC_PeriphCLKInitTypeDef PeriphClkInit = {0};

  /** Initializes the RCC Oscillators according to the specified parameters
  * in the RCC_OscInitTypeDef structure.
  */
  RCC_OscInitStruct.OscillatorType = RCC_OSCILLATORTYPE_HSE;
  RCC_OscInitStruct.HSEState = RCC_HSE_ON;
  RCC_OscInitStruct.HSEPredivValue = RCC_HSE_PREDIV_DIV1;
  RCC_OscInitStruct.HSIState = RCC_HSI_ON;
  RCC_OscInitStruct.PLL.PLLState = RCC_PLL_ON;
  RCC_OscInitStruct.PLL.PLLSource = RCC_PLLSOURCE_HSE;
  RCC_OscInitStruct.PLL.PLLMUL = RCC_PLL_MUL9;
  if (HAL_RCC_OscConfig(&RCC_OscInitStruct) != HAL_OK)
  {
    Error_Handler();
  }

  /** Initializes the CPU, AHB and APB buses clocks
  */
  RCC_ClkInitStruct.ClockType = RCC_CLOCKTYPE_HCLK|RCC_CLOCKTYPE_SYSCLK
                              |RCC_CLOCKTYPE_PCLK1|RCC_CLOCKTYPE_PCLK2;
  RCC_ClkInitStruct.SYSCLKSource = RCC_SYSCLKSOURCE_PLLCLK;
  RCC_ClkInitStruct.AHBCLKDivider = RCC_SYSCLK_DIV1;
  RCC_ClkInitStruct.APB1CLKDivider = RCC_HCLK_DIV2;
  RCC_ClkInitStruct.APB2CLKDivider = RCC_HCLK_DIV1;

  if (HAL_RCC_ClockConfig(&RCC_ClkInitStruct, FLASH_LATENCY_2) != HAL_OK)
  {
    Error_Handler();
  }
  PeriphClkInit.PeriphClockSelection = RCC_PERIPHCLK_ADC;
  PeriphClkInit.AdcClockSelection = RCC_ADCPCLK2_DIV6;
  if (HAL_RCCEx_PeriphCLKConfig(&PeriphClkInit) != HAL_OK)
  {
    Error_Handler();
  }
}

/* USER CODE BEGIN 4 */

/* USER CODE END 4 */

/**
  * @brief  This function is executed in case of error occurrence.
  * @retval None
  */
void Error_Handler(void)
{
  /* USER CODE BEGIN Error_Handler_Debug */
    /* User can add his own implementation to report the HAL error return state */
    __disable_irq();

    while (1)
    {
    }

  /* USER CODE END Error_Handler_Debug */
}
#ifdef USE_FULL_ASSERT
/**
  * @brief  Reports the name of the source file and the source line number
  *         where the assert_param error has occurred.
  * @param  file: pointer to the source file name
  * @param  line: assert_param error line source number
  * @retval None
  */
void assert_failed(uint8_t *file, uint32_t line)
{
  /* USER CODE BEGIN 6 */
    /* User can add his own implementation to report the file name and line number,
       ex: printf("Wrong parameters value: file %s on line %d\r\n", file, line) */
  /* USER CODE END 6 */
}
#endif /* USE_FULL_ASSERT */
